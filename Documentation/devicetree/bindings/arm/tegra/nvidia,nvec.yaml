## Documentation/devicetree/bindings/power/supply/cg7153am-battery.yaml
```yaml
# SPDX-License-Identifier: GPL-2.0
%YAML 1.2
---
$id: http://devicetree.org/schemas/power/supply/cg7153am-battery.yaml#
$schema: http://devicetree.org/meta-schemas/core.yaml#

title: Fuel gauge driver for Cypress CG7153AM based devices

maintainers:
  - Svyatoslav Ryhel <clamor95@gmail.com>

description: |
  The driver, apart from standard battery monitoring features,
  can utilize information from a simple-battery linked via a
  phandle in monitored-battery and gpio-charger. Additionally,
  driver can control power indication leds if correct flag is
  specified.

properties:
  compatible:
    const: cg7153am,battery

  reg:
    maxItems: 1

  cg7153am,leds-indication:
    type: boolean
    description: Enable power leds support

  monitored-battery:
    $ref: /schemas/types.yaml#/definitions/phandle
    description: |
      This property must be a phandle to a node using the format described
      in battery.yaml, with the following properties being required:
      - charge-full-design-microamp-hours: battery design capacity in microAh,
      - energy-full-design-microwatt-hours: battery design energy in microWh,
      - operating-range-celsius: operating temperature range of a battery.

  power-supplies:
    $ref: /schemas/types.yaml#/definitions/phandle-array
    description: |
      Specifies supplies used for charging the battery connected to this gauge.

required:
  - compatible
  - reg

additionalProperties: false

examples:
  - |
    #include <dt-bindings/gpio/gpio.h>

    i2c {
        #address-cells = <1>;
        #size-cells = <0>;

        fuel-gauge@10 {
          compatible = "cg7153am,battery";
          reg = <0x10>;

          cg7153am,leds-indication;

          monitored-battery = <&battery>;
          power-supplies = <&mains>;
        };
    };

    battery: battery-cell {
      compatible = "simple-battery";
      charge-full-design-microamp-hours = <3050000>;
      energy-full-design-microwatt-hours = <23000000>;
      operating-range-celsius = <0 45>;
    };

    mains: ac-adapter-detect {
      compatible = "gpio-charger";
      charger-type = "mains";
      gpios = <&gpio 169 GPIO_ACTIVE_HIGH>;
    };
...
```

## Documentation/devicetree/bindings/power/supply/summit,smb347-charger.yaml
```yaml
# SPDX-License-Identifier: (GPL-2.0-only OR BSD-2-Clause)
%YAML 1.2
---
$id: "http://devicetree.org/schemas/power/supply/summit,smb347-charger.yaml#"
$schema: "http://devicetree.org/meta-schemas/core.yaml#"

title: Battery charger driver for SMB345, SMB347 and SMB358

maintainers:
  - David Heidelberg <david@ixit.cz>

properties:
  compatible:
    enum:
      - summit,smb345
      - summit,smb347
      - summit,smb358

  reg:
    maxItems: 1

  interrupts:
    maxItems: 1

  summit,enable-usb-charging:
    type: boolean
    description: Enable charging trough USB.

  summit,enable-otg-charging:
    type: boolean
    description: Provide power for USB OTG

  summit,enable-mains-charging:
    type: boolean
    description: Enable charging trough mains

  summit,enable-chg-ctrl:
    description: Enable charging control
    allOf:
      - $ref: /schemas/types.yaml#/definitions/uint32
      - enum:
          - 0 # SMB3XX_CHG_ENABLE_SW SW (I2C interface)
          - 1 # SMB3XX_CHG_ENABLE_PIN_ACTIVE_LOW Pin control (Active Low)
          - 2 # SMB3XX_CHG_ENABLE_PIN_ACTIVE_HIGH Pin control (Active High)

  summit,max-chg-curr:
    description: Maximum current for charging (in uA)
    allOf:
      - $ref: /schemas/types.yaml#/definitions/uint32

  summit,max-chg-volt:
    description: Maximum voltage for charging (in uV)
    allOf:
      - $ref: /schemas/types.yaml#/definitions/uint32
    minimum: 3500000
    maximum: 4500000

  summit,pre-chg-curr:
    description: Pre-charging current for charging (in uA)
    allOf:
      - $ref: /schemas/types.yaml#/definitions/uint32

  summit,term-curr:
    description: Charging cycle termination current (in uA)
    allOf:
      - $ref: /schemas/types.yaml#/definitions/uint32

  summit,fast-volt-threshold:
    description: Voltage threshold to transit to fast charge mode (in uV)
    allOf:
      - $ref: /schemas/types.yaml#/definitions/uint32
    minimum: 2400000
    maximum: 3000000

  summit,mains-curr-limit:
    description: Maximum input current from AC/DC input (in uA)
    allOf:
      - $ref: /schemas/types.yaml#/definitions/uint32

  summit,usb-curr-limit:
    description: Maximum input current from USB input (in uA)
    allOf:
      - $ref: /schemas/types.yaml#/definitions/uint32

  summit,chg-curr-comp:
    description: Charge current compensation (in uA)
    allOf:
      - $ref: /schemas/types.yaml#/definitions/uint32

  summit,chip-temp-threshold:
    description: Chip temperature for thermal regulation in °C.
    allOf:
      - $ref: /schemas/types.yaml#/definitions/uint32
    enum: [100, 110, 120, 130]

  summit,soft-cold-temp-limit:
    description: Cold battery temperature in °C for soft alarm.
    allOf:
      - $ref: /schemas/types.yaml#/definitions/uint32
    enum: [0, 5, 10, 15]

  summit,soft-hot-temp-limit:
    description: Hot battery temperature in °C for soft alarm.
    allOf:
      - $ref: /schemas/types.yaml#/definitions/uint32
    enum: [40, 45, 50, 55]

  summit,hard-cold-temp-limit:
    description: Cold battery temperature in °C for hard alarm.
    allOf:
      - $ref: /schemas/types.yaml#/definitions/int32
    enum: [-5, 0, 5, 10]

  summit,hard-hot-temp-limit:
    description: Hot battery temperature in °C for hard alarm.
    allOf:
      - $ref: /schemas/types.yaml#/definitions/uint32
    enum: [50, 55, 60, 65]

  summit,soft-comp-method:
    description: Soft temperature limit compensation method
    allOf:
      - $ref: /schemas/types.yaml#/definitions/uint32
      - enum:
          - 0 # SMB3XX_SOFT_TEMP_COMPENSATE_NONE Compensation none
          - 1 # SMB3XX_SOFT_TEMP_COMPENSATE_CURRENT Current compensation
          - 2 # SMB3XX_SOFT_TEMP_COMPENSATE_VOLTAGE Voltage compensation

allOf:
  - if:
      properties:
        compatible:
          enum:
            - summit,smb345
            - summit,smb358

    then:
      properties:
        summit,max-chg-curr:
          enum: [ 200000,  450000,  600000,  900000,
                 1300000, 1500000, 1800000, 2000000]

        summit,pre-chg-curr:
          enum: [150000, 250000, 350000, 450000]

        summit,term-curr:
          enum: [ 30000,  40000,  60000,  80000,
                 100000, 125000, 150000, 200000]

        summit,mains-curr-limit:
          enum: [ 300000,  500000,  700000, 1000000,
                 1500000, 1800000, 2000000]

        summit,usb-curr-limit:
          enum: [ 300000,  500000,  700000, 1000000,
                 1500000, 1800000, 2000000]

        summit,chg-curr-comp:
          enum: [200000, 450000, 600000, 900000]

    else:
      properties:
        summit,max-chg-curr:
          enum: [ 700000,  900000, 1200000, 1500000,
                 1800000, 2000000, 2200000, 2500000]

        summit,pre-chg-curr:
          enum: [100000, 150000, 200000, 250000]

        summit,term-curr:
          enum: [ 37500,  50000, 100000, 150000,
                 200000, 250000, 500000, 600000]

        summit,mains-curr-limit:
          enum: [ 300000,  500000,  700000,  900000, 1200000,
                 1500000, 1800000, 2000000, 2200000, 2500000]

        summit,usb-curr-limit:
          enum: [ 300000,  500000,  700000,  900000, 1200000,
                 1500000, 1800000, 2000000, 2200000, 2500000]

        summit,chg-curr-comp:
          enum: [250000, 700000, 900000, 1200000]

required:
  - compatible
  - reg

anyOf:
  - required:
      - summit,enable-usb-charging
  - required:
      - summit,enable-otg-charging
  - required:
      - summit,enable-mains-charging

additionalProperties: false

examples:
  - |
    #include <dt-bindings/power/summit,smb347-charger.h>

    i2c {
        #address-cells = <1>;
        #size-cells = <0>;

        charger@7f {
            compatible = "summit,smb347";
            reg = <0x7f>;
            status = "okay";

            summit,max-chg-curr = <1800000>;
            summit,mains-curr-limit = <2000000>;
            summit,usb-curr-limit = <500000>;

            summit,chip-temp-threshold = <110>;
            summit,soft-cold-temp-limit = <5>;

            summit,enable-usb-charging;
            summit,enable-mains-charging;

            summit,enable-chg-ctrl = <SMB3XX_CHG_ENABLE_PIN_ACTIVE_HIGH>;
        };
    };
```

## Documentation/devicetree/bindings/regulator/ti,tps6586x.yaml
```yaml
# SPDX-License-Identifier: (GPL-2.0 OR BSD-2-Clause)
%YAML 1.2
---
$id: "http://devicetree.org/schemas/regulator/ti,tps6586x.yaml#"
$schema: "http://devicetree.org/meta-schemas/core.yaml#"

title: TPS6586x family of regulators

maintainers:
  - David Heidelberg <david@ixit.cz>

properties:
  compatible:
    const: ti,tps6586x

  reg: true
  interrupts: true

  "#gpio-cells":
    const: 2

  gpio-controller: true
  regulators:
    type: object
    description: |
      A node that houses a sub-node for each regulator within the
      device. Each sub-node is identified using the node's name (or the deprecated
      regulator-compatible property if present), with valid values listed below.
      The content of each sub-node is defined by the standard binding for
      regulators; see regulator.txt.
      sys, sm[0-2], ldo[0-9] and ldo_rtc

  sys-supply:
    description: The input supply for SYS.

  vin-sm0-supply:
    description: The input supply for the SM0.
  vin-sm1-supply:
    description: The input supply for the SM1.
  vin-sm2-supply:
    description: The input supply for the SM2.

  vinldo01-supply:
    description: The input supply for the LDO1 and LDO2
  vinldo23-supply:
    description: The input supply for the LDO2 and LDO3
  vinldo4-supply:
    description: The input supply for the LDO4
  vinldo678-supply:
    description: The input supply for the LDO6, LDO7 and LDO8
  vinldo9-supply:
    description: The input supply for the LDO9

  ti,system-power-controller:
    type: boolean
    description: |
      Telling whether or not this pmic is controlling the system power.

required:
  - compatible
  - reg
  - interrupts
  - '#gpio-cells'
  - gpio-controller
  - regulators
  - sys-supply
  - vin-sm0-supply
  - vin-sm1-supply
  - vin-sm2-supply
  - vinldo01-supply
  - vinldo23-supply
  - vinldo678-supply


# Each regulator is defined using the standard binding for regulators.
# Note: LDO5 and LDO_RTC is supplied by SYS regulator internally and driver
#       take care of making proper parent child relationship.

additionalProperties: false

examples:
  - |
    i2c {
      #address-cells = <1>;
      #size-cells = <0>;

      pmu: tps6586x@34 {
        compatible = "ti,tps6586x";
        reg = <0x34>;
        interrupts = <0 88 0x4>;

        #gpio-cells = <2>;
        gpio-controller;

        ti,system-power-controller;

        sys-supply = <&some_reg>;
        vin-sm0-supply = <&some_reg>;
        vin-sm1-supply = <&some_reg>;
        vin-sm2-supply = <&some_reg>;
        vinldo01-supply = <&some_reg>;
        vinldo23-supply = <&some_reg>;
        vinldo4-supply = <&some_reg>;
        vinldo678-supply = <&some_reg>;
        vinldo9-supply = <&some_reg>;

        regulators {
          sys_reg: sys {
            regulator-name = "vdd_sys";
            regulator-boot-on;
            regulator-always-on;
          };

          sm0_reg: sm0 {
            regulator-min-microvolt = < 725000>;
            regulator-max-microvolt = <1500000>;
            regulator-boot-on;
            regulator-always-on;
          };

          sm1_reg: sm1 {
            regulator-min-microvolt = < 725000>;
            regulator-max-microvolt = <1500000>;
            regulator-boot-on;
            regulator-always-on;
          };

          sm2_reg: sm2 {
            regulator-min-microvolt = <3000000>;
            regulator-max-microvolt = <4550000>;
            regulator-boot-on;
            regulator-always-on;
          };

          ldo0_reg: ldo0 {
            regulator-name = "PCIE CLK";
            regulator-min-microvolt = <3300000>;
            regulator-max-microvolt = <3300000>;
          };

          ldo1_reg: ldo1 {
            regulator-min-microvolt = < 725000>;
            regulator-max-microvolt = <1500000>;
          };

          ldo2_reg: ldo2 {
            regulator-min-microvolt = < 725000>;
            regulator-max-microvolt = <1500000>;
          };

          ldo3_reg: ldo3 {
            regulator-min-microvolt = <1250000>;
            regulator-max-microvolt = <3300000>;
          };

          ldo4_reg: ldo4 {
            regulator-min-microvolt = <1700000>;
            regulator-max-microvolt = <2475000>;
          };

          ldo5_reg: ldo5 {
            regulator-min-microvolt = <1250000>;
            regulator-max-microvolt = <3300000>;
          };

          ldo6_reg: ldo6 {
            regulator-min-microvolt = <1250000>;
            regulator-max-microvolt = <3300000>;
          };

          ldo7_reg: ldo7 {
            regulator-min-microvolt = <1250000>;
            regulator-max-microvolt = <3300000>;
          };

          ldo8_reg: ldo8 {
            regulator-min-microvolt = <1250000>;
            regulator-max-microvolt = <3300000>;
          };

          ldo9_reg: ldo9 {
            regulator-min-microvolt = <1250000>;
            regulator-max-microvolt = <3300000>;
          };
        };
      };
    };
```

## Documentation/devicetree/bindings/rtc/nvidia,tegra-rtc.yaml
```yaml
# SPDX-License-Identifier: (GPL-2.0 OR BSD-2-Clause)
%YAML 1.2
---
$id: "http://devicetree.org/schemas/rtc/nvidia,tegra-rtc.yaml#"
$schema: "http://devicetree.org/meta-schemas/core.yaml#"

title: NVIDIA Tegra real-time clock

description: |
  The Tegra RTC maintains seconds and milliseconds counters, and five alarm
  registers. The alarms and other interrupts may wake the system from low-power
  state.

maintainers:
  - David Heidelberg <david@ixit.cz>

properties:
  compatible:
    anyOf:
      - items:
          - enum:
              - nvidia,tegra30-rtc
              - nvidia,tegra114-rtc
              - nvidia,tegra124-rtc
              - nvidia,tegra132-rtc
          - const: nvidia,tegra20-rtc
      - items:
          enum:
            - nvidia,tegra20-rtc
            - nvidia,tegra30-rtc
            - nvidia,tegra114-rtc
            - nvidia,tegra124-rtc
            - nvidia,tegra132-rtc
  reg: true
  interrupts: true
  clocks: true

required:
  - compatible
  - reg
  - interrupts
  - clocks

additionalProperties: false

examples:
  - |
    timer@7000e000 {
      compatible = "nvidia,tegra20-rtc";
      reg = <0x7000e000 0x100>;
      interrupts = <0 2 0x04>;
      clocks = <&tegra_car 4>;
    };
```

## Documentation/devicetree/bindings/sound/alc5632.yaml
```yaml
# SPDX-License-Identifier: (GPL-2.0 OR BSD-2-Clause)
%YAML 1.2
---
$id: "http://devicetree.org/schemas/sound/alc5632.yaml#"
$schema: "http://devicetree.org/meta-schemas/core.yaml#"

title: ALC5632 audio codec

description: |
  This device supports I2C only.
  Pins on the device (for linking into audio routes) for ALC5632:
  * SPK_OUTP
  * SPK_OUTN
  * HP_OUT_L
  * HP_OUT_R
  * AUX_OUT_P
  * AUX_OUT_N
  * LINE_IN_L
  * LINE_IN_R
  * PHONE_P
  * PHONE_N
  * MIC1_P
  * MIC1_N
  * MIC2_P
  * MIC2_N
  * MICBIAS1
  * DMICDAT

maintainers:
  - David Heidelberg <david@ixit.cz>

properties:
  compatible:
    const: realtek,alc5632

  reg: true

  gpio-controller: true
  '#gpio-cells':
    const: 2

required:
  - compatible
  - reg
  - gpio-controller
  - '#gpio-cells'

additionalProperties: false

examples:
  - |
    i2c {
      #address-cells = <1>;
      #size-cells = <0>;

      alc5632@1e {
        compatible = "realtek,alc5632";
        reg = <0x1e>;

        gpio-controller;
        #gpio-cells = <2>;
      };
    };
```
