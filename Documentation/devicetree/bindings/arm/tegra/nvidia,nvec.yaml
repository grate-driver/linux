## Documentation/devicetree/bindings/input/mcs-touchkey.txt
```
* mcs_touchkey MELFAS MCS5000/5080 controller

Required properties:
- compatible: must be "mcs5000_touchkey" or "mcs5080_touchkey"
- reg : I2C address of the chip
- interrupts: interrupt to which the chop is connected
- key_maxval: size of keycode table
- interrupts: interrupt to which the chip is connected
- code: key code for this device

Example:

	i2c_touch_key: i2c-gpio-0 {
	       /* ... */

	       touch_key@20 {
		       compatible = "mcs5080_touchkey";
		       reg = <0x20>;
		       interrupt-patrent = <gpj0>;
		       key_maxval = <2>;
		       linux, code = <0x0000009e
			              0x000000a9>;
	       };

	       /* ... */
	};
```

## Documentation/devicetree/bindings/input/mcs-touchkey.yaml
```yaml
# SPDX-License-Identifier: (GPL-2.0-only OR BSD-2-Clause)
%YAML 1.2
---
$id: http://devicetree.org/schemas/input/mcs-touchkey.yaml#
$schema: http://devicetree.org/meta-schemas/core.yaml#

title: MELFAS MCS5000/5080 controller

maintainers:
  - Rob Herring <robh@kernel.org>

properties:
  compatible:
    enum:
      - mcs5000_touchkey
      - mcs5080_touchkey

  reg:
    maxItems: 1

  interrupts:
    maxItems: 1

  key_maxval:
    $ref: /schemas/types.yaml#/definitions/uint32
    description: size of keycode table

  linux,code:
    $ref: /schemas/types.yaml#/definitions/uint32-array
    description: key code for this device

required:
  - compatible
  - reg
  - interrupts
  - linux,code

additionalProperties: false

examples:
  - |
    i2c-gpio-0 {
      #address-cells = <1>;
      #size-cells = <0>;

      melfas-touchkey@20 {
        compatible = "mcs5080_touchkey";
        reg = <0x20>;
        interrupts = <100>;
        key_maxval = <4>;
        linux,code = <139 102 158 217>;
      };
    };
```

## Documentation/devicetree/bindings/media/nvidia,tegra-cec.yaml
```yaml
# SPDX-License-Identifier: (GPL-2.0 OR BSD-2-Clause)
%YAML 1.2
---
$id: "http://devicetree.org/schemas/media/nvidia,tegra-cec.yaml#"
$schema: "http://devicetree.org/meta-schemas/core.yaml#"

title: Tegra HDMI CEC hardware

description: |
  The HDMI CEC module is present in Tegra SoCs and its purpose is to
  handle communication between HDMI connected devices over the CEC bus.

maintainers:
  - Jon Hunter <jonathanh@nvidia.com>
  - Thierry Reding <thierry.reding@gmail.com>

properties:
  compatible:
    enum:
      - nvidia,tegra114-cec
      - nvidia,tegra124-cec
      - nvidia,tegra210-cec

  reg: true
  '#address-cells':
    const: 2
  '#size-cells':
    const: 0

  interrupts:
    description: HDMI CEC interrupt number to the CPU.

  clocks:
    maxItems: 1

  clock-names:
    items:
      - const: cec

  # see cec.txt
  hdmi-phandle:
    description: phandle to the HDMI controller

required:
  - compatible
  - reg
  - interrupts

additionalProperties: false

examples:
  - |
    #include <dt-bindings/clock/tegra124-car-common.h>
    #include <dt-bindings/interrupt-controller/arm-gic.h>
    #include <dt-bindings/interrupt-controller/irq.h>
    cec@70015000 {
      compatible = "nvidia,tegra124-cec";
      reg = <0x70015000 0x00001000>;
      interrupts = <GIC_SPI 3 IRQ_TYPE_LEVEL_HIGH>;
      clocks = <&tegra_car TEGRA124_CLK_CEC>;
      clock-names = "cec";
    };
```

## Documentation/devicetree/bindings/mfd/asus-ec.yaml
```yaml
# SPDX-License-Identifier: GPL-2.0-only OR BSD-2-Clause
%YAML 1.2
---
$id: http://devicetree.org/schemas/mfd/asus-ec.yaml#
$schema: http://devicetree.org/meta-schemas/core.yaml#

title: Nuvoton NPCE795LA0BX Embedded Controller bindings

description: |
  This binding describes the Nuvoton NPCE795LA0BX Embedded Controller
  attached to an I2C bus and running firmware that is specific to the
  Asus Transformer device series.

maintainers:
  - Michał Mirosław <mirq-linux@rere.qmqm.pl>
  - Svyatoslav Ryhel <clamor95@gmail.com>

properties:
  compatible:
    items:
      - enum:
          - asus,pad-ec  # Pad part of Asus Transformer
          - asus,dock-ec # Dock part of Asus Transformer
      - const: asus,ec
  reg:
    maxItems: 1

  interrupts:
    maxItems: 1

  request-gpio:
    maxItems: 1

  asus,dockram:
    $ref: /schemas/types.yaml#/definitions/phandle
    description: |
      I2C device used to read/write embedded controller.

  monitored-battery:
    $ref: /schemas/types.yaml#/definitions/phandle
    description: |
      This property must be a phandle to a node using the format described
      in battery.yaml, with the following properties being required:
      - charge-full-design-microamp-hours: battery design capacity in microAh,
      - energy-full-design-microwatt-hours: battery design energy in microWh,
      - operating-range-celsius: operating temperature range of a battery.

  power-supplies:
    $ref: /schemas/types.yaml#/definitions/phandle-array
    description: |
      Specifies supplies used for charging the battery connected to this gauge.
    minItems: 1
    maxItems: 4 # Should be enough

required:
  - compatible
  - reg
  - interrupts
  - request-gpio
  - asus,dockram

additionalProperties: false

examples:
  - |
    #include <dt-bindings/gpio/gpio.h>
    #include <dt-bindings/interrupt-controller/irq.h>

    pad_battery: pad-battery {
      compatible = "simple-battery";
      charge-full-design-microamp-hours = <3380000>;
      energy-full-design-microwatt-hours = <25000000>;
      operating-range-celsius = <0 45>;
    };

    mains: ac-adapter-detect {
      compatible = "gpio-charger";
      charger-type = "mains";
      gpios = <&gpio 61 GPIO_ACTIVE_HIGH>;
    };

    dock_ac: dock-charger {
      compatible = "gpio-charger";
      charger-type = "ups";
      gpios = <&gpio 149 GPIO_ACTIVE_LOW>;
    };

    i2c {
      #address-cells = <1>;
      #size-cells = <0>;

      embedded-controller@15 {
        compatible = "asus,pad-ec", "asus,ec";
        reg = <0x15>;

        interrupt-parent = <&gpio>;
        interrupts = <146 IRQ_TYPE_LEVEL_LOW>;

        request-gpio = <&gpio 129 1>;
        asus,dockram = <&dockram_ec>;

        monitored-battery = <&pad_battery>;
        power-supplies = <&mains>, <&dock_ac>;
      };

      dockram_ec: dockram@17 {
        compatible = "asus,dockram";
        reg = <0x17>;
      };
    };
...
```

## Documentation/devicetree/bindings/mfd/cypress,cg7153am.yaml
```yaml
# SPDX-License-Identifier: GPL-2.0
%YAML 1.2
---
$id: http://devicetree.org/schemas/mfd/cypress,cg7153am.yaml#
$schema: http://devicetree.org/meta-schemas/core.yaml#

title: Cypress CG7153AM Embedded Controller bindings

maintainers:
  - Svyatoslav Ryhel <clamor95@gmail.com>

description: |
  This binding describes the Cypress CG7153AM Embedded Controller attached
  to an I2C bus.

properties:
  compatible:
    items:
      - enum:
          - pegatron,chagall-ec # Pegatron Chagall tablet device
      - const: cypress,cg7153am

  reg:
    maxItems: 1

  monitored-battery: true
  power-supplies: true

required:
  - compatible
  - reg

additionalProperties: false

examples:
  - |
    #include <dt-bindings/gpio/gpio.h>

    i2c {
        #address-cells = <1>;
        #size-cells = <0>;

        embedded-controller@10 {
          compatible = "pegatron,chagall-ec";
          reg = <0x10>;

          monitored-battery = <&battery>;
          power-supplies = <&mains>;
        };
    };

    battery: battery-cell {
      compatible = "simple-battery";
      charge-full-design-microamp-hours = <3050000>;
      energy-full-design-microwatt-hours = <23000000>;
      operating-range-celsius = <0 45>;
    };

    mains: ac-adapter-detect {
      compatible = "gpio-charger";
      charger-type = "mains";
      gpios = <&gpio 169 GPIO_ACTIVE_HIGH>;
    };
...
```
