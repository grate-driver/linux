## Documentation/devicetree/bindings/misc/asus-dockram.yaml
```yaml
# SPDX-License-Identifier: GPL-2.0
%YAML 1.2
---
$id: http://devicetree.org/schemas/misc/asus-dockram.yaml#
$schema: http://devicetree.org/meta-schemas/core.yaml#

title: Asus Dockram support

maintainers:
  - Michał Mirosław <mirq-linux@rere.qmqm.pl>

description: |
  I2C device used to read/write Asus Transformers embedded controller.

properties:
  compatible:
    const: asus,dockram

  reg:
    maxItems: 1

required:
  - compatible
  - reg

additionalProperties: false

examples:
  - |
    i2c {
      #address-cells = <1>;
      #size-cells = <0>;

      dockram@17 {
        compatible = "asus,dockram";
        reg = <0x17>;
      };
    };
...
```

## Documentation/devicetree/bindings/mmc/nvidia,tegra-sdhci.yaml
```yaml
# SPDX-License-Identifier: (GPL-2.0 OR BSD-2-Clause)
%YAML 1.2
---
$id: "http://devicetree.org/schemas/mmc/nvidia,tegra-sdhci.yaml#"
$schema: "http://devicetree.org/meta-schemas/core.yaml#"

title: NVIDIA Tegra Secure Digital Host Controller

description: |
  This controller on Tegra family SoCs provides an interface for MMC, SD,
  and SDIO types of memory cards.

  This file documents differences between the core properties described
  by mmc.txt and the properties used by the sdhci-tegra driver.

maintainers:
  - Dmitry Osipenko <digetx@gmail.com>

properties:
  compatible:
    oneOf:
      - items:
          enum:
            - nvidia,tegra20-sdhci
            - nvidia,tegra30-sdhci
            - nvidia,tegra114-sdhci
            - nvidia,tegra124-sdhci
            - nvidia,tegra186-sdhci
            - nvidia,tegra194-sdhci
            - nvidia,tegra210-sdhci

  reg: true
  interrupts: true

  clocks:
    description: |
      For Tegra210, Tegra186 and Tegra194 must contain two entries.
      One for the module clock and one for the timeout clock.
      For all other Tegra devices, must contain a single entry for
      the module clock.

  clock-names: true

  resets:
    maxItems: 1

  reset-names:
    items:
      - const: sdhci

  power-gpios:
    description: Specify GPIOs for power control


  #  Optional properties for Tegra210, Tegra186 and Tegra194:
  pinctrl-0: true

  pinctrl-1:
    description:
      Specify pad voltage
      configurations. Valid pinctrl-names are "sdmmc-3v3" and "sdmmc-1v8"
      for controllers supporting multiple voltage levels. The order of names
      should correspond to the pin configuration states in pinctrl-0 and
      pinctrl-1.

  pinctrl-names:
    description: |
      "sdmmc-3v3-drv" and "sdmmc-1v8-drv" are applicable for
      Tegra210 where pad config registers are in the pinmux register domain
      for pull-up-strength and pull-down-strength values configuration when
      using pads at 3V3 and 1V8 levels.

  bus-width:
    $ref: /schemas/types.yaml#/definitions/uint32
    enum: [4, 8]

  # FIXME ? no-1-8-v really?
  no-1-8-v:
    type: boolean
    description: |
      The presence of this property indicates that the
      controller doesn't operates at a 1.8 V fixed I/O voltage.

  nvidia,pad-autocal-pull-up-offset-3v3:
    $ref: /schemas/types.yaml#/definitions/uint32
    description: FIXME TODO

  nvidia,pad-autocal-pull-down-offset-3v3:
    $ref: /schemas/types.yaml#/definitions/uint32
    description: |
      Specify drive strength
      calibration offsets for 3.3 V signaling modes.

  nvidia,pad-autocal-pull-up-offset-1v8:
    $ref: /schemas/types.yaml#/definitions/uint32
    description: FIXME TODO

  nvidia,pad-autocal-pull-down-offset-1v8:
    $ref: /schemas/types.yaml#/definitions/uint32
    description: |
      Specify drive strength
      calibration offsets for 1.8 V signaling modes.
      nvidia,pad-autocal-pull-up-offset-3v3-timeout,

  nvidia,pad-autocal-pull-down-offset-3v3-timeout:
    $ref: /schemas/types.yaml#/definitions/uint32
    description: |
      Specify drive
      strength used as a fallback in case the automatic calibration times
      out on a 3.3 V signaling mode.

  nvidia,pad-autocal-pull-up-offset-1v8-timeout:
    $ref: /schemas/types.yaml#/definitions/uint32
    description: FIXME TODO

  nvidia,pad-autocal-pull-down-offset-1v8-timeout:
    $ref: /schemas/types.yaml#/definitions/uint32
    description: |
      Specify drive
      strength used as a fallback in case the automatic calibration times
      out on a 1.8 V signaling mode.

  nvidia,pad-autocal-pull-up-offset-sdr104:
    $ref: /schemas/types.yaml#/definitions/uint32
    description: FIXME TODO

  nvidia,pad-autocal-pull-down-offset-sdr104:
    $ref: /schemas/types.yaml#/definitions/uint32
    description: |
      Specify drive strength
      calibration offsets for SDR104 mode.

  nvidia,default-tap:
    $ref: /schemas/types.yaml#/definitions/uint32
    description: |
      Specify the default inbound sampling clock trimmer value for non-tunable modes.

  nvidia,default-trim:
    $ref: /schemas/types.yaml#/definitions/uint32
    description: Specify the default outbound clock trimmer value.

  power-domains: true

  operating-points-v2: true

# TODO FIXME
#  Notes on the pad calibration pull up and pulldown offset values:
#    - The property values are drive codes which are programmed into the
#      PD_OFFSET and PU_OFFSET sections of the
#      SDHCI_TEGRA_AUTO_CAL_CONFIG register.
#    - A higher value corresponds to higher drive strength. Please refer
#      to the reference manual of the SoC for correct values.
#    - The SDR104 and HS400 timing specific values are used in
#      corresponding modes if specified.
#
#  Notes on tap and trim values:
#    - The values are used for compensating trace length differences
#      by adjusting the sampling point.
#    - The values are programmed to the Vendor Clock Control Register.
#      Please refer to the reference manual of the SoC for correct
#      values.

allOf:
  - if:
      properties:
        compatible:
          contains:
            enum:
              - nvidia,tegra186-sdhci
              - nvidia,tegra194-sdhci
              - nvidia,tegra210-sdhci
    then:
      properties:
        clocks:
          minItems: 2
          maxItems: 2

        clock-names:
          items:
            - const: sdhci # the module clock
            - const: tmclk # the timeout clock
    else:
      properties:
        clocks:
          maxItems: 1

        clock-names:
          items:
            - const: sdhci # the module clock

  - if:
      properties:
        compatible:
          contains:
            enum:
              - nvidia,tegra186-sdhci
              - nvidia,tegra210-sdhci
    then:
      properties:
        nvidia,pad-autocal-pull-up-offset-hs400:
          $ref: /schemas/types.yaml#/definitions/uint32
          minimum: 0x00
          maximum: 0xff
          description: |
            Specify drive strength calibration pull-up offset for HS400 mode.

        nvidia,pad-autocal-pull-down-offset-hs400:
          $ref: /schemas/types.yaml#/definitions/uint32
          minimum: 0x00
          maximum: 0xff
          description: |
            Specify drive strength calibration pull-down offset for HS400 mode.

        nvidia,dqs-trim:
          $ref: /schemas/types.yaml#/definitions/uint32
          description: |
            Specify DQS trim value for HS400 timing.
            Supported only on SDMMC4.

required:
  - clocks
  - clock-names
  - resets
  - reset-names

additionalProperties: true

examples:
  - |
    sdhci@c8000200 {
        compatible = "nvidia,tegra20-sdhci";
        reg = <0xc8000200 0x200>;
        interrupts = <47>;
        clocks = <&tegra_car 14>;
        clock-names = "sdhci";
        resets = <&tegra_car 14>;
        reset-names = "sdhci";
        cd-gpios = <&gpio 69 0>;
        wp-gpios = <&gpio 57 0>;
        power-gpios = <&gpio 155 0>;
        bus-width = <8>;
    };

  - |
    #include <dt-bindings/clock/tegra210-car.h>
    #include <dt-bindings/interrupt-controller/arm-gic.h>
    #include <dt-bindings/interrupt-controller/irq.h>

    sdhci@700b0000 {
        compatible = "nvidia,tegra124-sdhci";
        reg = <0x700b0000 0x200>;
        interrupts = <GIC_SPI 14 IRQ_TYPE_LEVEL_HIGH>;
        clocks = <&tegra_car TEGRA210_CLK_SDMMC1>;
        clock-names = "sdhci";
        resets = <&tegra_car 14>;
        reset-names = "sdhci";
        pinctrl-names = "sdmmc-3v3", "sdmmc-1v8";
        pinctrl-0 = <&sdmmc1_3v3>;
        pinctrl-1 = <&sdmmc1_1v8>;
        nvidia,pad-autocal-pull-up-offset-3v3 = <0x00>;
        nvidia,pad-autocal-pull-down-offset-3v3 = <0x7d>;
        nvidia,pad-autocal-pull-up-offset-1v8 = <0x7b>;
        nvidia,pad-autocal-pull-down-offset-1v8 = <0x7b>;
        status = "disabled";
    };

  - |
    #include <dt-bindings/clock/tegra210-car.h>
    #include <dt-bindings/interrupt-controller/arm-gic.h>
    #include <dt-bindings/interrupt-controller/irq.h>

    sdhci@700b0000 {
        compatible = "nvidia,tegra210-sdhci";
        reg = <0x700b0000 0x200>;
        interrupts = <GIC_SPI 14 IRQ_TYPE_LEVEL_HIGH>;
        clocks = <&tegra_car TEGRA210_CLK_SDMMC1>,
                 <&tegra_car TEGRA210_CLK_SDMMC_LEGACY>;
        clock-names = "sdhci", "tmclk";
        resets = <&tegra_car 14>;
        reset-names = "sdhci";
        pinctrl-names = "sdmmc-3v3", "sdmmc-1v8";
        pinctrl-0 = <&sdmmc1_3v3>;
        pinctrl-1 = <&sdmmc1_1v8>;
        nvidia,pad-autocal-pull-up-offset-3v3 = <0x00>;
        nvidia,pad-autocal-pull-down-offset-3v3 = <0x7d>;
        nvidia,pad-autocal-pull-up-offset-1v8 = <0x7b>;
        nvidia,pad-autocal-pull-down-offset-1v8 = <0x7b>;
        status = "disabled";
    };
```

## Documentation/devicetree/bindings/power/nvidia,tegra20-core-domain.yaml
```yaml
# SPDX-License-Identifier: GPL-2.0-only OR BSD-2-Clause
%YAML 1.2
---
$id: http://devicetree.org/schemas/power/nvidia,tegra20-core-domain.yaml#
$schema: http://devicetree.org/meta-schemas/core.yaml#

title: NVIDIA Tegra Core Power Domain

maintainers:
  - Dmitry Osipenko <digetx@gmail.com>
  - Jon Hunter <jonathanh@nvidia.com>
  - Thierry Reding <thierry.reding@gmail.com>

allOf:
  - $ref: power-domain.yaml#

properties:
  compatible:
    enum:
      - nvidia,tegra20-core-domain
      - nvidia,tegra30-core-domain

  operating-points-v2:
    description:
      Should contain level, voltages and opp-supported-hw property.
      The supported-hw is a bitfield indicating SoC speedo or process
      ID mask.

  "#power-domain-cells":
    const: 0

  power-supply:
    description:
      Phandle to voltage regulator connected to the SoC Core power rail.

required:
  - compatible
  - operating-points-v2
  - "#power-domain-cells"
  - power-supply

additionalProperties: false

examples:
  - |
    power-domain {
        compatible = "nvidia,tegra20-core-domain";
        operating-points-v2 = <&opp_table>;
        power-supply = <&regulator>;
        #power-domain-cells = <0>;
    };
```

## Documentation/devicetree/bindings/power/reset/gpio-restart.yaml
```yaml
# SPDX-License-Identifier: (GPL-2.0 OR BSD-2-Clause)
%YAML 1.2
---
$id: "http://devicetree.org/schemas/power/reset/gpio-restart.yaml#"
$schema: "http://devicetree.org/meta-schemas/core.yaml#"

title: Drive a GPIO line that can be used to restart the system from a restart handler

description: |
  This binding supports level and edge triggered reset.  At driver load
  time, the driver will request the given gpio line and install a restart
  handler. If the optional properties 'open-source' is not found, the GPIO line
  will be driven in the inactive state.  Otherwise its not driven until
  the restart is initiated.

  When the system is restarted, the restart handler will be invoked in
  priority order.  The gpio is configured as an output, and driven active,
  triggering a level triggered reset condition. This will also cause an
  inactive->active edge condition, triggering positive edge triggered
  reset. After a delay specified by active-delay, the GPIO is set to
  inactive, thus causing an active->inactive edge, triggering negative edge
  triggered reset. After a delay specified by inactive-delay, the GPIO
  is driven active again.  After a delay specified by wait-delay, the
  restart handler completes allowing other restart handlers to be attempted.

maintainers:
  - David Heidelberg <david@ixit.cz>

properties:
  compatible:
    const: gpio-restart

  gpios:
    maxItems: 1
    description: |
      If the pin should be low to reset the board set it to "Active Low",
      otherwise set gpio to "Active High".

  open-source:
    description: |
      Treat the GPIO as being open source and defer driving
      it to when the restart is initiated.  If this optional property is not
      specified, the GPIO is initialized as an output in its inactive state.

  priority:
    $ref: /schemas/types.yaml#/definitions/uint32
    minimum: 0
    maximum: 255
    description: |
      A priority according to the following guidelines:
          0:  Restart handler of last resort, with limited restart capabilities
        128:  Default restart handler; use if no other restart handler is
              expected to be available, and/or if restart functionality is
              sufficient to restart the entire system
        255:  Highest priority restart handler, will preempt all other restart handlers
  active-delay:
    $ref: /schemas/types.yaml#/definitions/uint32
    description: Delay (default 100) to wait after driving gpio active [ms]
  inactive-delay:
    $ref: /schemas/types.yaml#/definitions/uint32
    description: Delay (default 100) to wait after driving gpio inactive [ms]
  wait-delay:
    $ref: /schemas/types.yaml#/definitions/uint32
    description: Delay (default 3000) to wait after completing restart sequence [ms]

required:
  - compatible
  - gpios

additionalProperties: false

examples:
  - |
    gpio-restart {
      compatible = "gpio-restart";
      gpios = <&gpio 4 0>;
      priority = <128>;
      active-delay = <100>;
      inactive-delay = <100>;
      wait-delay = <3000>;
    };
```
