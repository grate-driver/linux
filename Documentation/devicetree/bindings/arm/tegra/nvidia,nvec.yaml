## Documentation/devicetree/bindings/arm/tegra/nvidia,nvec.yaml
```yaml
# SPDX-License-Identifier: (GPL-2.0-only OR BSD-2-Clause)
%YAML 1.2
---
$id: http://devicetree.org/schemas/arm/tegra/nvidia,nvec.yaml#
$schema: http://devicetree.org/meta-schemas/core.yaml#

title: NVIDIA compliant embedded controller

maintainers:
  - Thierry Reding <treding@nvidia.com>
  - Jon Hunter <jonathanh@nvidia.com>

properties:
  compatible:
    const: nvidia,nvec

  reg:
    maxItems: 1

  interrupts: true

  clock-frequency:
    description: the frequency of the i2c bus

  gpios: true

  request-gpios:
    maxItems: 1

  slave-addr:
    description: the i2c address of the slave controller

  clocks:
    minItems: 2
    maxItems: 2

  clock-names:
    items:
      - const: div-clk
      - const: fast-clk

  resets:
    maxItems: 1

  reset-names:
    const: i2c

  '#address-cells':
    const: 1

  '#size-cells':
    const: 0

additionalProperties: false

examples:
  - |
    #include <dt-bindings/clock/tegra20-car.h>
    #include <dt-bindings/gpio/tegra-gpio.h>
    #include <dt-bindings/interrupt-controller/arm-gic.h>
    #include <dt-bindings/interrupt-controller/irq.h>
    nvec@7000c500 {
      compatible = "nvidia,nvec";
      reg = <0x7000c500 0x100>;
      interrupts = <GIC_SPI 92 IRQ_TYPE_LEVEL_HIGH>;
      #address-cells = <1>;
      #size-cells = <0>;
      clock-frequency = <80000>;
      request-gpios = <&gpio TEGRA_GPIO(V, 2) GPIO_ACTIVE_HIGH>;
      slave-addr = <138>;
      clocks = <&tegra_car TEGRA20_CLK_I2C3>,
               <&tegra_car TEGRA20_CLK_PLL_P_OUT3>;
      clock-names = "div-clk", "fast-clk";
      resets = <&tegra_car 67>;
      reset-names = "i2c";
    };
```

## Documentation/devicetree/bindings/arm/tegra/nvidia,tegra20-vde.txt
```
NVIDIA Tegra Video Decoder Engine

Required properties:
- compatible : "nvidia,tegra20-vde"
- reg : Must contain 2 register ranges: registers and IRAM region that
        VDE uses for its internal needs and for passing some of decoding
        parameters.
- reg-names : Must include the following entries:
  - regs
  - iram
- interrupts : Must contain an entry for each entry in interrupt-names.
- interrupt-names : Must include the following entries:
  - ucq-error
  - sync-token
  - bsev
  - bsea
  - sxe
- clocks : Must contain an entry for each entry in clock-names.
  See ../clocks/clock-bindings.txt for details.
- clock-names : Must include the following entries:
  - vde
- resets : Must contain an entry for each entry in reset-names.
  See ../reset/reset.txt for details.
- reset-names : Must include the following entries:
  - vde

Example:

vde@6001a000 {
	compatible = "nvidia,tegra20-vde";
	reg = <0x6001a000 0x3D00    /* VDE registers */
		0x40000400 0x3FC00>; /* IRAM region */
	reg-names = "regs", "iram";
	interrupts = <GIC_SPI  8 IRQ_TYPE_LEVEL_HIGH>, /* UCQ error interrupt */
			<GIC_SPI  9 IRQ_TYPE_LEVEL_HIGH>, /* Sync token interrupt */
			<GIC_SPI 10 IRQ_TYPE_LEVEL_HIGH>, /* BSE-V interrupt */
			<GIC_SPI 11 IRQ_TYPE_LEVEL_HIGH>, /* BSE-A interrupt */
			<GIC_SPI 12 IRQ_TYPE_LEVEL_HIGH>; /* SXE interrupt */
	interrupt-names = "ucq-error", "sync-token", "bsev", "bsea", "sxe";
	clocks = <&tegra_car TEGRA20_CLK_VDE>;
	clock-names = "vde";
	resets = <&tegra_car 61>;
	reset-names = "vde";
};
```

## Documentation/devicetree/bindings/dma/nvidia,tegra20-ahbdma.txt
```
* NVIDIA Tegra AHB DMA controller

Required properties:
- compatible:	Should be "nvidia,tegra20-ahbdma", "nvidia,tegra30-ahbdma".
- reg:		Must contain registers base address and length.
- interrupts:	Must contain one entry, DMA controller interrupt.
- clocks:	Must contain one entry, DMA controller clock.
- resets :	Must contain one entry, DMA controller reset.
- #dma-cells:	Must be <1>. The cell represents DMA request select value
		for the peripheral. For more details consult the Tegra TRM
		documentation, in particular REQ_SEL field of the AHB DMA
		channel control register.

Example:

dma-controller@60008000  {
	compatible = "nvidia,tegra20-ahbdma";
	reg = <0x60008000 0x2000>;
	interrupts = <GIC_SPI 27 IRQ_TYPE_LEVEL_HIGH>;
	clocks = <&tegra_car TEGRA20_CLK_AHBDMA>;
	resets = <&tegra_car 33>;
	#dma-cells = <1>;
};
```

## Documentation/devicetree/bindings/dsp/fortemedia,dsp.yaml
```yaml
# SPDX-License-Identifier: GPL-2.0
%YAML 1.2
---
$id: http://devicetree.org/schemas/dsp/fortemedia,dsp.yaml#
$schema: http://devicetree.org/meta-schemas/core.yaml#

title: Fortemedia DSP core

maintainers:
  - Svyatoslav Ryhel <clamor95@gmail.com>

description: |
  Asus Transformer T20/T30 tablet family contains a DSP core
  used for advanced noise cancellation.

properties:
  compatible:
    items:
      - enum:
          - asus,tf101-dsp
          - asus,tf201-dsp
          - asus,tf300t-dsp
          - asus,tf700t-dsp
          - pegatron,chagall-dsp

      - const: fortemedia,fm34

  reg:
    maxItems: 1

  bypass-gpios:
    maxItems: 1

  reset-gpios:
    maxItems: 1

  vdd-supply: true

  clocks:
    maxItems: 1

  clock-names:
    items:
      - const: mclk

  assigned-clocks:
    maxItems: 1

  assigned-clock-parents:
    maxItems: 1

  assigned-clock-rates:
    maxItems: 1

required:
  - compatible
  - reg
  - vdd-supply

additionalProperties: false

examples:
  - |
    #include <dt-bindings/clock/tegra30-car.h>
    #include <dt-bindings/soc/tegra-pmc.h>

    i2c {
        #address-cells = <1>;
        #size-cells = <0>;

        dsp@60 {
            compatible = "asus,tf201-dsp", "fortemedia,fm34";
            reg = <0x60>;

            bypass-gpios = <&gpio 222 0>;
            reset-gpios = <&gpio 115 1>;

            vdd-supply = <&vdd_1v8_dsp>;

            clocks = <&tegra_pmc TEGRA_PMC_CLK_OUT_1>;
            clock-names = "mclk";

            assigned-clocks = <&tegra_pmc TEGRA_PMC_CLK_OUT_1>;
            assigned-clock-parents = <&tegra_car TEGRA30_CLK_EXTERN1>;
        };
    };
 
    vdd_1v8_dsp: regulator-dsp {
        compatible = "regulator-fixed";
        regulator-name = "vdd_1v8_dsp";
        regulator-min-microvolt = <1800000>;
        regulator-max-microvolt = <1800000>;
        gpio = <&gpio 165 0>;
        enable-active-high;
    };
```

## Documentation/devicetree/bindings/hwmon/lm90.yaml
```yaml
# SPDX-License-Identifier: (GPL-2.0-only or BSD-2-Clause)
%YAML 1.2
---
$id: http://devicetree.org/schemas/hwmon/lm90.yaml#
$schema: http://devicetree.org/meta-schemas/core.yaml#

title: LM90 hwmon sensor

maintainers:
  - David Heidelberg <david@ixit.cz>

properties:
  compatible:
    enum:
      - adi,adm1032
      - adi,adt7461
      - adi,adt7461a
      - gmt,g781
      - national,lm90
      - national,lm86
      - national,lm89
      - national,lm99
      - dallas,max6646
      - dallas,max6647
      - dallas,max6649
      - dallas,max6657
      - dallas,max6658
      - dallas,max6659
      - dallas,max6680
      - dallas,max6681
      - dallas,max6695
      - dallas,max6696
      - onnn,nct1008
      - winbond,w83l771
      - nxp,sa56004
      - ti,tmp451

  reg:
    maxItems: 1

  vcc-supply:
    description: phandle to the regulator that provides the +VCC supply

  interrupts:
    maxItems: 1
    description: Contains interrupt specifier which describes the -ALERT pin output.

  '#thermal-sensor-cells':
    const: 1

required:
  - compatible
  - reg

additionalProperties: false

examples:
  - |
    #include <dt-bindings/gpio/tegra-gpio.h>
    #include <dt-bindings/interrupt-controller/irq.h>
    i2c {
      #address-cells = <1>;
      #size-cells = <0>;

      sensor@4c {
        compatible = "onnn,nct1008";
        reg = <0x4c>;
        vcc-supply = <&palmas_ldo6_reg>;
        interrupt-parent = <&gpio>;
        interrupts = <TEGRA_GPIO(O, 4) IRQ_TYPE_LEVEL_LOW>;
        #thermal-sensor-cells = <1>;
      };
    };
```

## Documentation/devicetree/bindings/i2c/i2c-hotplug-gpio.yaml
```yaml
# SPDX-License-Identifier: GPL-2.0
%YAML 1.2
---
$id: http://devicetree.org/schemas/i2c/i2c-hotplug-gpio.yaml#
$schema: http://devicetree.org/meta-schemas/core.yaml#

title: hot-plugged I2C bus detected by GPIO.

maintainers:
  - Michał Mirosław <mirq-linux@rere.qmqm.pl>

description: |+
  Driver for hot-plugged I2C busses: where some devices on a bus
  are hot-pluggable and their presence is indicated by GPIO line.

properties:
  compatible:
    items:
      - const: i2c-hotplug-gpio

  '#address-cells':
    const: 1

  '#size-cells':
    const: 0

  interrupts-extended:
    minItems: 1

  detect-gpios:
    maxItems: 1

  i2c-parent:
    maxItems: 1

required:
  - compatible
  - "#address-cells"
  - "#size-cells"
  - interrupts-extended
  - detect-gpios
  - i2c-parent

additionalProperties: false

examples:
  - |
    /*
     * Asus Transformers use I2C hotplug for attachable dock keyboard
     */

    dock-i2c {
        compatible = "i2c-hotplug-gpio";

        #address-cells = <1>;
        #size-cells = <0>;

        interrupts-extended = <&gpio 164 IRQ_TYPE_EDGE_BOTH>;
        detect-gpios = <&gpio 164 1>;

        i2c-parent = <&{/i2c@7000c400}>;
    };
...
```

## Documentation/devicetree/bindings/i2c/nvidia,tegra-i2c.yaml
```yaml
# SPDX-License-Identifier: (GPL-2.0-only OR BSD-2-Clause)
%YAML 1.2
---
$id: http://devicetree.org/schemas/i2c/nvidia,tegra-i2c.yaml#
$schema: http://devicetree.org/meta-schemas/core.yaml#

title: NVIDIA Tegra I2C controller driver

maintainers:
  - No-one <no-one@no-one.org>

allOf:
  - $ref: /schemas/i2c/i2c-controller.yaml#
  - if:
      properties:
        compatible:
          contains:
            enum:
              - nvidia,tegra20-i2c
              - nvidia,tegra30-i2c
    then:
      properties:
        clock-names:
          items:
            - const: div-clk
            - const: fast-clk
  - if:
      properties:
        compatible:
          contains:
            enum:
              - nvidia,tegra114-i2c
              - nvidia,tegra210-i2c
    then:
      properties:
        clock-names:
          items:
            - const: div-clk
  - if:
      properties:
        compatible:
          contains:
            const: nvidia,tegra210-i2c-vi
    then:
      properties:
        clock-names:
          items:
            - const: div-clk
            - const: slow

properties:
  compatible:
    oneOf:
      - description: |
          Tegra20 has 4 generic I2C controller. This can support
          master and slave mode of I2C communication. The i2c-tegra driver
          only support master mode of I2C communication.
        items:
          - const: nvidia,tegra20-i2c

      - description: |
          Tegra20 has specific I2C controller called as DVC I2C
          controller. This only support master mode of I2C communication.
          Register interface/offset and interrupts handling are different
          than generic I2C controller.
        items:
          - const: nvidia,tegra20-i2c-dvc

      - description: |
          Tegra30 has 5 generic I2C controller. This controller is
          very much similar to Tegra20 I2C controller with additional feature:
          Continue Transfer Support. This feature helps to implement M_NO_START
          as per I2C core API transfer flags. Driver of I2C controller is
          compatible with "nvidia,tegra30-i2c" to enable the continue transfer
          support. This is also compatible with "nvidia,tegra20-i2c" without
          continue transfer support.
        items:
          - const: nvidia,tegra30-i2c
          - const: nvidia,tegra20-i2c

      - description: |
          Tegra114 has 5 generic I2C controller. This controller is very
          much similar to Tegra30 I2C controller with some hardware modification:
          - Tegra30/Tegra20 I2C controller has 2 clock source called div-clk and
          fast-clk. Tegra114 has only one clock source called as div-clk and
          hence clock mechanism is changed in I2C controller.
          - Tegra30/Tegra20 I2C controller has enabled per packet transfer by
          default and there is no way to disable it. Tegra114 has this
          interrupt disable by default and SW need to enable explicitly.
          Due to above changes, Tegra114 I2C driver makes incompatible with
          previous hardware driver.
        items:
          - const: nvidia,tegra114-i2c

      - items:
          - const: nvidia,tegra124-i2c
          - const: nvidia,tegra114-i2c
      - items:
          - const: nvidia,tegra210-i2c
          - const: nvidia,tegra124-i2c
      - description: |
          Tegra210 has one I2C controller that is on host1x bus
          and is part of VE power domain and typically used for camera use-cases.
          This VI I2C controller is mostly compatible with the programming model
          of the regular I2C controllers with a few exceptions. The I2C registers
          start at an offset of 0xc00 (instead of 0), registers are 16 bytes
          apart (rather than 4) and the controller does not support slave mode.
        items:
          - const: nvidia,tegra210-i2c-vi
      - items:
          - const: nvidia,tegra186-i2c
          - const: nvidia,tegra210-i2c

  reg: true
  interrupts: true

  '#address-cells':
    const: 1
  '#size-cells':
    const: 0

  clocks: true
  clock-names: true

  clock-frequency:
    minimum: 1
    default: 100000
    maximum: 400000
    description: Desired operating frequency, in Hz, of the bus.

  resets: true
  reset-names:
    items:
      - const: i2c

  power-domains:
    description: |
      Only for nvidia,tegra210-i2c-vi compatible node and must
      include venc powergate node as vi i2c is part of VE power domain.
      tegra210-i2c-vi:
        - pd_venc
  dmas:
    description: |
      Must contain an entry for each entry in clock-names.
  dma-names:
    items:
      - const: rx
      - const: tx

required:
  - compatible
  - clocks
  - clock-names

unevaluatedProperties: false

examples:
  - |
    i2c@7000c000 {
      compatible = "nvidia,tegra20-i2c";
      reg = <0x7000c000 0x100>;
      interrupts = <0 38 0x04>;
      #address-cells = <1>;
      #size-cells = <0>;
      clocks = <&tegra_car 12>, <&tegra_car 124>;
      clock-names = "div-clk", "fast-clk";
      resets = <&tegra_car 12>;
      reset-names = "i2c";
      dmas = <&apbdma 16>, <&apbdma 16>;
      dma-names = "rx", "tx";
    };
```

## Documentation/devicetree/bindings/input/imagis,isa1200.yaml
```yaml
# SPDX-License-Identifier: (GPL-2.0-only OR BSD-2-Clause)
%YAML 1.2
---
$id: http://devicetree.org/schemas/input/imagis,isa1200.yaml#
$schema: http://devicetree.org/meta-schemas/core.yaml#

title: Imagis ISA1200 Haptic Driver - ERM/LRA Actuator, PWM Input Control, Serial Interface

maintainers:
  - David Heidelberg <david@ixit.cz>

properties:
  compatible:
    const: imagis,isa1200

  reg:
    maxItems: 1

  clocks: true
  clock-names:
    maxItems: 1

  enable-gpio: true

  max-timeout: true
  pll: true
  duty: true
  period: true

  pinctrl-names:
    items:
      - const: on
      - const: off
  pinctrl-0: true
  pinctrl-1: true

patternProperties:
  '^ctrl[0-4]$':
    maxItems: 1

required:
  - compatible
  - reg

additionalProperties: false

examples:
  - |
    #include <dt-bindings/clock/tegra20-car.h>
    #include <dt-bindings/gpio/tegra-gpio.h>
    #include <dt-bindings/interrupt-controller/arm-gic.h>
    i2c {
      #address-cells = <1>;
      #size-cells = <0>;

      isa1200@48 {
        compatible = "imagis,isa1200";
        reg = <0x48>;
        enable-gpio = <&gpio TEGRA_GPIO(R, 6) GPIO_ACTIVE_HIGH>;

        max-timeout = <10000>;
        ctrl0 = <17>;
        ctrl1 = <192>;
        ctrl2 = <0>;
        ctrl4 = <0>;
        pll = <0x23>;
        duty = <0x85>;
        period = <0x86>;

        clocks = <&tegra_car TEGRA20_CLK_CDEV2>;
        clock-names = "vibrator-clk";

        pinctrl-names = "on", "off";
        pinctrl-0 = <&state_isa1200_on>;
        pinctrl-1 = <&state_isa1200_off>;
      };
    };
```
