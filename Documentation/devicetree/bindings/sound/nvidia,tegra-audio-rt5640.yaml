## Documentation/devicetree/bindings/sound/nvidia,tegra-audio-rt5640.yaml
```yaml
# SPDX-License-Identifier: (GPL-2.0 OR BSD-2-Clause)
%YAML 1.2
---
$id: "http://devicetree.org/schemas/sound/nvidia,tegra-audio-rt5640.yaml#"
$schema: "http://devicetree.org/meta-schemas/core.yaml#"

title: NVIDIA Tegra audio complex, with RT5640 codec

description: |
  The device node for a USB controller that is part of a Tegra
  SOC is as described in the document
  "Open Firmware Recommended Practice Universal Serial Bus"
  with the following modifications and additions

maintainers:
  - Jon Hunter <jonathanh@nvidia.com>
  - Thierry Reding <thierry.reding@gmail.com>

properties:
  compatible:
    oneOf:
      - items:
          - pattern: '^nvidia,tegra-audio-rt5640-.*$'
          - const: nvidia,tegra-audio-rt5640
      - items:
          - const: nvidia,tegra-audio-rt5640

  clocks:
    items:
      - description: PLL A clock
      - description: PLL A OUT 0 clock
      - description: The Tegra cdev1/extern1 clock, which feeds the CODEC's mclk

  clock-names:
    items:
      - const: pll_a
      - const: pll_a_out0
      - const: mclk

  nvidia,model:
    $ref: /schemas/types.yaml#/definitions/string
    description: The user-visible name of this sound complex.

  nvidia,audio-routing:
    $ref: /schemas/types.yaml#/definitions/non-unique-string-array
    description: |
      A list of the connections between audio components.
      Each entry is a pair of strings, the first being the connection's sink,
      the second being the connection's source. Valid names for sources and
      sinks are the RT5640's pins (as documented in its binding), and the jacks
      on the board:

      * Headphones
      * Speakers
      * Mic Jack

  nvidia,i2s-controller:
    $ref: /schemas/types.yaml#/definitions/phandle
    description: |
      The phandle of the Tegra I2S controller that's
      connected to the CODEC.

  nvidia,audio-codec:
    $ref: /schemas/types.yaml#/definitions/phandle
    description: Phandle of the RT5640 audio codec.

  nvidia,hp-det-gpios:
    description: GPIO that detects headphones plug-in.
    maxItems: 1

additionalProperties: false

required:
  - compatible
  - clocks
  - clock-names
  - nvidia,model
  - nvidia,audio-routing
  - nvidia,i2s-controller
  - nvidia,audio-codec


examples:
  - |
    #include <dt-bindings/clock/tegra30-car.h>
    #include <dt-bindings/soc/tegra-pmc.h>
    #include <dt-bindings/gpio/gpio.h>
    sound {
      compatible = "nvidia,tegra-audio-rt5640-dalmore",
                   "nvidia,tegra-audio-rt5640";
      nvidia,model = "NVIDIA Tegra Dalmore";

      nvidia,audio-routing =
              "Headphones", "HPOR",
              "Headphones", "HPOL",
              "Speakers", "SPORP",
              "Speakers", "SPORN",
              "Speakers", "SPOLP",
              "Speakers", "SPOLN";

      nvidia,i2s-controller = <&tegra_i2s1>;
      nvidia,audio-codec = <&rt5640>;

      nvidia,hp-det-gpios = <&gpio 143 0>; /* GPIO PR7 */

      clocks = <&tegra_car 216>, <&tegra_car 217>, <&tegra_car 120>;
      clock-names = "pll_a", "pll_a_out0", "mclk";
    };
```

## Documentation/devicetree/bindings/sound/nvidia,tegra-audio-sgtl5000.yaml
```yaml
# SPDX-License-Identifier: (GPL-2.0-only OR BSD-2-Clause)
%YAML 1.2
---

$id: http://devicetree.org/schemas/sound/nvidia,tegra-audio-sgtl5000.yaml#
$schema: http://devicetree.org/meta-schemas/core.yaml#

title: NVIDIA Tegra audio complex, with SGTL5000 codec

maintainers:
  - Marcel Ziswiler <marcel.ziswiler@toradex.com>

properties:
  compatible:
    anyOf:
      - items:
          - enum:
              - toradex,tegra-audio-sgtl5000-apalis_t30
              - toradex,tegra-audio-sgtl5000-colibri_t30
              - toradex,tegra-audio-sgtl5000-apalis_tk1
          - const: nvidia,tegra-audio-sgtl5000
      - const: nvidia,tegra-audio-sgtl5000

  clocks:
    items:
      - description: PLL A clock
      - description: PLL A OUT0 clock
      - description: The Tegra cdev1/extern1 clock, which feeds the card's mclk

  clock-names:
    items:
      - const: pll_a
      - const: pll_a_out0
      - const: mclk

  nvidia,model:
    $ref: /schemas/types.yaml#/definitions/string
    description: User-visible name of this sound complex.

  nvidia,audio-routing:
    $ref: /schemas/types.yaml#/definitions/non-unique-string-array
    description: |
      A list of the connections between audio components.
      Each entry is a pair of strings, the first being the connection's sink,
      the second being the connection's source. Valid names for sources and
      sinks are the SGTL5000's pins (as documented in its binding), and the jacks
      on the board:

      * Headphone Jack
      * Line In Jack
      * Mic Jack

  nvidia,i2s-controller:
    $ref: /schemas/types.yaml#/definitions/phandle
    description: Phandle of the Tegra I2S controller.

  nvidia,audio-codec:
    $ref: /schemas/types.yaml#/definitions/phandle
    description: Phandle of the SGTL5000 audio codec.

additionalProperties: false

examples:
  - |
    #include <dt-bindings/clock/tegra30-car.h>
    sound {
      compatible = "toradex,tegra-audio-sgtl5000-apalis_t30",
                   "nvidia,tegra-audio-sgtl5000";
      nvidia,model = "Toradex Apalis T30";
      nvidia,audio-routing =
              "Headphone Jack", "HP_OUT",
              "LINE_IN", "Line In Jack",
              "MIC_IN", "Mic Jack";
      nvidia,i2s-controller = <&tegra_i2s2>;
      nvidia,audio-codec = <&sgtl5000>;
      clocks = <&tegra_car TEGRA30_CLK_PLL_A>,
               <&tegra_car TEGRA30_CLK_PLL_A_OUT0>,
               <&tegra_car TEGRA30_CLK_EXTERN1>;
      clock-names = "pll_a", "pll_a_out0", "mclk";
    };
```

## Documentation/devicetree/bindings/sound/nvidia,tegra-audio-wm8903.yaml
```yaml
# SPDX-License-Identifier: (GPL-2.0 OR BSD-2-Clause)
%YAML 1.2
---
$id: "http://devicetree.org/schemas/sound/nvidia,tegra-audio-wm8903.yaml#"
$schema: "http://devicetree.org/meta-schemas/core.yaml#"

title: NVIDIA Tegra audio complex

maintainers:
  - Jon Hunter <jonathanh@nvidia.com>
  - Thierry Reding <thierry.reding@gmail.com>

properties:
  compatible:
    oneOf:
      - items:
          - enum:
              - ad,tegra-audio-wm8903-tec
              - ad,tegra-audio-wm8903-medcom-wide
              - ad,tegra-audio-plutux
              - nvidia,tegra-audio-wm8903-harmony
              - nvidia,tegra-audio-wm8903-seaboard
              - nvidia,tegra-audio-wm8903-ventana
              - nvidia,tegra-audio-wm8903-cardhu
              - nvidia,tegra-audio-wm8903-chagall
              - nvidia,tegra-audio-wm8903-tf101
              - nvidia,tegra-audio-wm8903-tf300t
              - nvidia,tegra-audio-wm8903-picasso
          - const: nvidia,tegra-audio-wm8903
      - const: nvidia,tegra-audio-wm8903

  clocks:
    items:
      - description: PLL A clock
      - description: PLL A OUT0 clock
      - description: The Tegra cdev1/extern1 clock, which feeds the card's mclk
  clock-names:
    items:
      - const: pll_a
      - const: pll_a_out0
      - const: mclk

  nvidia,model:
    $ref: /schemas/types.yaml#/definitions/string
    description: The user-visible name of this sound complex.

  nvidia,audio-routing:
    $ref: /schemas/types.yaml#/definitions/non-unique-string-array
    description: |
      A list of the connections between audio components.
      Each entry is a pair of strings, the first being the connection's sink,
      the second being the connection's source. Valid names for sources and
      sinks are the WM8903's pins (documented in the WM8903 binding document),
      and the jacks on the board:
        * Headphone Jack
        * Int Spk
        * Mic Jack
        * Int Mic

  nvidia,i2s-controller:
    $ref: /schemas/types.yaml#/definitions/phandle
    description: The phandle of the Tegra I2S1 controller

  nvidia,audio-codec:
    $ref: /schemas/types.yaml#/definitions/phandle
    description: The phandle of the WM8903 audio codec

  nvidia,spkr-en-gpios:
    maxItems: 1
    description: The GPIO that enables the speakers

  nvidia,hp-mute-gpios:
    maxItems: 1
    description: The GPIO that mutes the headphones

  nvidia,hp-det-gpios:
    maxItems: 1
    description: The GPIO that detect headphones are plugged in

  nvidia,int-mic-en-gpios:
    maxItems: 1
    description: The GPIO that enables the internal microphone

  nvidia,ext-mic-en-gpios:
    maxItems: 1
    description: The GPIO that enables the external microphone

  nvidia,headset:
    type: boolean
    description: The Mic Jack represents state of the headset microphone pin

additionalProperties: false

required:
  - compatible
  - clocks
  - clock-names
  - nvidia,model
  - nvidia,audio-routing
  - nvidia,i2s-controller
  - nvidia,audio-codec

examples:
  - |
    sound {
      compatible = "nvidia,tegra-audio-wm8903-harmony",
                   "nvidia,tegra-audio-wm8903";
      nvidia,model = "tegra-wm8903-harmony";

      nvidia,audio-routing =
              "Headphone Jack", "HPOUTR",
              "Headphone Jack", "HPOUTL",
              "Int Spk", "ROP",
              "Int Spk", "RON",
              "Int Spk", "LOP",
              "Int Spk", "LON",
              "Mic Jack", "MICBIAS",
              "IN1L", "Mic Jack";

      nvidia,i2s-controller = <&i2s1>;
      nvidia,audio-codec = <&wm8903>;

      nvidia,spkr-en-gpios = <&codec 2 0>;
      nvidia,hp-det-gpios = <&gpio 178 0>; /* gpio PW2 */
      nvidia,int-mic-en-gpios = <&gpio 184 0>; /*gpio PX0 */
      nvidia,ext-mic-en-gpios = <&gpio 185 0>; /* gpio PX1 */

      clocks = <&tegra_car 112>, <&tegra_car 113>, <&tegra_car 93>;
      clock-names = "pll_a", "pll_a_out0", "mclk";
    };
```

## Documentation/devicetree/bindings/sound/nvidia,tegra-audio-wm8994.yaml
```yaml
# SPDX-License-Identifier: (GPL-2.0-only OR BSD-2-Clause)
%YAML 1.2
---
$id: http://devicetree.org/schemas/sound/nvidia,tegra-audio-wm8994.yaml#
$schema: http://devicetree.org/meta-schemas/core.yaml#

title: NVIDIA Tegra audio complex with WM8994 CODEC

maintainers:
  - Jon Hunter <jonathanh@nvidia.com>
  - Thierry Reding <thierry.reding@gmail.com>

allOf:
  - $ref: nvidia,tegra-audio-common.yaml#

properties:
  compatible:
    oneOf:
      - items:
          - pattern: '^[a-z0-9]+,tegra-audio-wm8994(-[a-z0-9]+)+$'
          - const: nvidia,tegra-audio-wm8994

  nvidia,audio-routing:
    $ref: /schemas/types.yaml#/definitions/non-unique-string-array
    description: |
      A list of the connections between audio components.
      Each entry is a pair of strings, the first being the connection's sink,
      the second being the connection's source. Valid names for sources and
      sinks are the pins (documented in the binding document),
      and the jacks on the board.
    minItems: 2
    items:
      enum:
        # Board Connectors
        - "Headphone Jack"
        - "Int Spk"
        - "Mic Jack"
        - "Int Mic"

        # CODEC Pins TODO
        - FIXME

  nvidia,ear-sel-gpios:
    maxItems: 1
    description: The GPIO that switch between the microphones

required:
  - nvidia,i2s-controller

unevaluatedProperties: false

examples:
  - |
    sound {
        compatible = "samsung,tegra-audio-wm8994-p4wifi", "nvidia,tegra-audio-wm8994";
        nvidia,model = "Samsung Galaxy Tab 10.1 WM8994";

        nvidia,i2s-controller = <&tegra_i2s1>;
        nvidia,audio-codec = <&wm8994>;

        clocks = <&clk 211>, <&clk 153>, <&clk 200>;
        clock-names = "pll_a", "pll_a_out0", "mclk";
    };
```
