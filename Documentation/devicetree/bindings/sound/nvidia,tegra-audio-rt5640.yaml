## drivers/staging/a500-ec/Kconfig
```kconfig
config ACER_A500_EC_MFD
	bool "Embedded Controller driver for Acer Iconia Tab A500"
	depends on I2C_TEGRA && ARCH_TEGRA_2x_SOC
	select MFD_CORE
	help
	  Say Y to include support for Acer Iconia Tab A500 Embedded
	  Controller.

config ACER_A500_EC_LEGACY_SYSFS
	tristate "Legacy Android compatibility for Acer Iconia Tab A500"
	depends on ACER_A500_EC_MFD
	help
	  Say Y to include support for legacy Android sysfs.

config ACER_A500_EC_BATTERY
	tristate "Acer Iconia Tab A500 battery driver"
	depends on ACER_A500_EC_MFD && POWER_SUPPLY
	help
	  Say Y to include support for battery driver.

config ACER_A500_EC_LEDS
	tristate "Power button LED support for Acer Iconia Tab A500"
	depends on ACER_A500_EC_MFD && LEDS_CLASS
	help
	  Say Y to enable control of power button LED.
```

## drivers/staging/android/Kconfig
```kconfig
# SPDX-License-Identifier: GPL-2.0
menu "Android"

source "drivers/staging/android/ramconsole/Kconfig"
```

## drivers/staging/dsp/Kconfig
```kconfig
# SPDX-License-Identifier: GPL-2.0
config DSP_FM34NE
	tristate "DSP FM34NE driver"
	depends on I2C && GPIOLIB
	help
	  Say Y or M here if you want to add support for Fortemedia FM34NE
	  DSP mainly used on ASUS T20/T30 Transformers.
```

## drivers/staging/p4wifi/Kconfig
```kconfig
config P4WIFI
	bool "Samsung Galaxy Tab 10.1 drivers"
	default n
	help
	  Say Y to build Samsung Galaxy Tab 10.1 drivers.

if P4WIFI

config SAMSUNG_JACK
	bool "3.5MM ear jack driver for Samsung devices"
	depends on INPUT && EXTCON
	depends on STMPE_ADC
	default n
	help
	 This is 3.5MM ear jack driver for Samsung devices.
	 Please check configurations on board file,
	 and you shoud check gpio_input driver is ready.

	 If unsure, say N.

endif # P4WIFI
```

## drivers/staging/tegra-vde/Kconfig
```kconfig
config TEGRA_VDE
	tristate "NVIDIA Tegra Video Decoder Engine driver"
	depends on ARCH_TEGRA_2x_SOC || COMPILE_TEST
	help
	    Say Y here to enable support for the NVIDIA Tegra video decoder
	    driver.
```
