## Documentation/devicetree/bindings/sound/wlf,wm8994.yaml
```yaml
# SPDX-License-Identifier: (GPL-2.0 OR BSD-2-Clause)
%YAML 1.2
---
$id: "http://devicetree.org/schemas/sound/wlf,wm8994.yaml#"
$schema: "http://devicetree.org/meta-schemas/core.yaml#"

title: WM1811/WM8994/WM8958 audio codec

description: |
  These devices support both I2C and SPI (configured with pin strapping on the board).
  Pins on the device (for linking into audio routes):
    * IN1LN
    * IN1LP
    * IN2LN
    * IN2LP:VXRN
    * IN1RN
    * IN1RP
    * IN2RN
    * IN2RP:VXRP
    * SPKOUTLP
    * SPKOUTLN
    * SPKOUTRP
    * SPKOUTRN
    * HPOUT1L
    * HPOUT1R
    * HPOUT2P
    * HPOUT2N
    * LINEOUT1P
    * LINEOUT1N
    * LINEOUT2P
    * LINEOUT2N

maintainers:
  - patches@opensource.cirrus.com

allOf:
  - if:
      properties:
        compatible:
          contains:
            enum:
              - wlf,wm1811
              - wlf,wm8958
    then:
      required:
        - DBVDD1-supply
        - DBVDD2-supply
        - DBVDD3-supply

  - if:
      properties:
        compatible:
          contains:
            const: wlf,wm8994
    then:
      required:
        - DBVDD-supply

properties:
  compatible:
    enum:
      - wlf,wm1811
      - wlf,wm8994
      - wlf,wm8958

  reg:
    description: the I2C address of the device, the chip select number for SPI.

  gpio-controller: true

  '#gpio-cells':
    const: 2
    description: |
      The first cell is the pin number and the second cell is used to
      specify optional parameters (currently unused).


  interrupts:
    maxItems: 1

  interrupt-controller: true

  '#interrupt-cells':
    const: 2
    description: |
      The first cell is the IRQ number.
      The second cell is the flags, encoded as the trigger masks from
      Documentation/devicetree/bindings/interrupt-controller/interrupts.txt

  clocks:
    maxItems: 2

  clock-names:
    enum:
      - MCLK1
      - MCLK2

  wlf,gpio-cfg:
    $ref: /schemas/types.yaml#/definitions/uint32-array
    minItems: 11
    maxItems: 11
    description: |
      A list of GPIO configuration register values.
      If absent, no configuration of these registers is performed.
      If any value is over 0xffff then the register will be left as default.

  wlf,micbias-cfg:
    $ref: /schemas/types.yaml#/definitions/uint32-array
    minItems: 1
    maxItems: 2
    description: |
      Two MICBIAS register values for WM1811 or WM8958.
      If absent the register defaults will be used.

  wlf,ldoena-always-driven:
    type: boolean
    description: If present LDOENA is always driven.

  wlf,spkmode-pu:
    type: boolean
    description: If present enable the internal pull-up resistor on the SPKMODE pin.

  wlf,csnaddr-pd:
    type: boolean
    description: If present enable the internal pull-down resistor on the CS/ADDR pin.

  CPVDD-supply:
    description: Charge pump supply regulator on the CPVDD pin.

  DBVDD-supply:
    description: Digital buffer supply regulator for the DBVDD pin.

  DCVDD-supply:
    description: Digital core supply regulator for the DCVDD pin.

patternProperties:
  "^wlf,ldo[1-2]ena$":
    $ref: /schemas/types.yaml#/definitions/uint32-array
    description: GPIO specifier for control of LDOxENA input to device.

  "^wlf,lineout[1-2]-se$":
    type: boolean
    description: If present LINEOUT is in single ended mode.

  "^wlf,lineout[1-2]-feedback$":
    type: boolean
    description: If present LINEOUT has common mode feedback connected.

  "^AVDD[1-2]-supply$":
    description: Analog power supply regulator on the AVDD pin.

  "^SPKVDD[1-2]-supply$":
    description: Speaker power supply regulator on the SPKVDD pin.

required:
  - compatible
  - reg
  - gpio-controller
  - '#gpio-cells'
  - AVDD1-supply
  - AVDD2-supply
  - DCVDD-supply
  - CPVDD-supply
  - SPKVDD1-supply
  - SPKVDD2-supply

additionalProperties: false

examples:
  - |
    i2c {
      #address-cells = <1>;
      #size-cells = <0>;

      wm8994: codec@1a {
        compatible = "wlf,wm8994";
        reg = <0x1a>;

        gpio-controller;
        #gpio-cells = <2>;

        wlf,lineout1-se;

        AVDD1-supply = <&regulator>;
        AVDD2-supply = <&regulator>;
        CPVDD-supply = <&regulator>;
        DBVDD-supply = <&regulator>;
        DCVDD-supply = <&regulator>;
        SPKVDD1-supply = <&regulator>;
        SPKVDD2-supply = <&regulator>;
      };
    };
```

## Documentation/devicetree/bindings/spi/nvidia,tegra114-spi.yaml
```yaml
# SPDX-License-Identifier: (GPL-2.0 OR BSD-2-Clause)
%YAML 1.2
---
$id: "http://devicetree.org/schemas/spi/nvidia,tegra114-spi.yaml#"
$schema: "http://devicetree.org/meta-schemas/core.yaml#"

title: NVIDIA Tegra114 SPI controller

maintainers:
  - None of None <none@none.com>

properties:
  compatible:
    anyOf:
      - items:
          - enum:
              - nvidia,tegra124
              - nvidia,tegra132
              - nvidia,tegra210
          - const: nvidia,tegra114-slink
      - items:
          enum:
            - nvidia,tegra114-spi
            - nvidia,tegra124-spi
            - nvidia,tegra132-spi
            - nvidia,tegra210-spi

  reg:
    description: Should contain SPI registers location and length.

  interrupts:
    description: Should contain SPI interrupts.

  clocks: true
  clock-names:
    items:
      - const: spi
  resets:
    maxItems: 1
  reset-names:
    items:
      - const: spi
  dmas:
    minItems: 2
    maxItems: 2

  dma-names:
    items:
      - const: rx
      - const: tx

  spi-max-frequency: true

  nvidia,tx-clk-tap-delay:
    $ref: /schemas/types.yaml#/definitions/uint32
    minimum: 0
    maximum: 63
    description: |
      Delays the clock going out to the external device
      with this tap value. This property is used to tune the outgoing data from
      Tegra SPI master with respect to outgoing Tegra SPI master clock.
      Tap values vary based on the platform design trace lengths from Tegra SPI
      to corresponding slave devices.

  nvidia,rx-clk-tap-delay:
    $ref: /schemas/types.yaml#/definitions/uint32
    minimum: 0
    maximum: 63
    description: |
      Delays the clock coming in from the external device
      with this tap value. This property is used to adjust the Tegra SPI master
      clock with respect to the data from the SPI slave device.
      Tap values vary based on the platform design trace lengths from Tegra SPI
      to corresponding slave devices.

  '#address-cells':
    const: 1
  '#size-cells':
    const: 0

required:
  - compatible
  - reg
  - clocks
  - clock-names
  - resets
  - reset-names
  - dmas
  - dma-names

additionalProperties: true

examples:
  - |
    spi@7000d600 {
      compatible = "nvidia,tegra114-spi";
      reg = <0x7000d600 0x200>;
      interrupts = <0 82 0x04>;
      spi-max-frequency = <25000000>;
      #address-cells = <1>;
      #size-cells = <0>;
      clocks = <&tegra_car 44>;
      clock-names = "spi";
      resets = <&tegra_car 44>;
      reset-names = "spi";
      dmas = <&apbdma 16>, <&apbdma 16>;
      dma-names = "rx", "tx";
    };
```

## Documentation/devicetree/bindings/spi/nvidia,tegra20-sflash.yaml
```yaml
# SPDX-License-Identifier: (GPL-2.0 OR BSD-2-Clause)
%YAML 1.2
---
$id: "http://devicetree.org/schemas/spi/nvidia,tegra20-sflash.yaml#"
$schema: "http://devicetree.org/meta-schemas/core.yaml#"

title: NVIDIA Tegra20 SFLASH controller

maintainers:
  - Thierry Reding <treding@nvidia.com>
  - Jon Hunter <jonathanh@nvidia.com>

allOf:
  - $ref: "spi-controller.yaml"

properties:
  compatible:
    const: nvidia,tegra20-sflash

  reg: true
  interrupts: true

  clocks:
    maxItems: 1

  resets:
    maxItems: 1
  reset-names:
    items:
      - const: spi

  dmas:
    minItems: 2
    maxItems: 2

  dma-names:
    items:
      - const: rx
      - const: tx

  spi-max-frequency: true

  '#address-cells':
    const: 1
  '#size-cells':
    const: 0

required:
  - compatible
  - reg
  - interrupts
  - clocks
  - resets
  - reset-names
  - dmas
  - dma-names

unevaluatedProperties: false

examples:
  - |
    spi@7000c380 {
        compatible = "nvidia,tegra20-sflash";
        reg = <0x7000c380 0x80>;
        interrupts = <0 39 0x04>;
        spi-max-frequency = <25000000>;
        #address-cells = <1>;
        #size-cells = <0>;
        clocks = <&tegra_car 43>;
        resets = <&tegra_car 43>;
        reset-names = "spi";
        dmas = <&apbdma 11>, <&apbdma 11>;
        dma-names = "rx", "tx";
    };
```

## Documentation/devicetree/bindings/spi/nvidia,tegra20-slink.yaml
```yaml
# SPDX-License-Identifier: (GPL-2.0 OR BSD-2-Clause)
%YAML 1.2
---
$id: "http://devicetree.org/schemas/spi/nvidia,tegra20-slink.yaml#"
$schema: "http://devicetree.org/meta-schemas/core.yaml#"

title: NVIDIA Tegra20/Tegra30 SLINK controller

maintainers:
  - Thierry Reding <treding@nvidia.com>
  - Jon Hunter <jonathanh@nvidia.com>

allOf:
  - $ref: "spi-controller.yaml"

properties:
  compatible:
    anyOf:
      - items:
          - const: nvidia,tegra30-slink
          - const: nvidia,tegra20-slink
      - items:
          enum:
            - nvidia,tegra20-slink
            - nvidia,tegra30-slink

  reg:
    description: Should contain SLINK registers location and length.

  interrupts:
    description: Should contain SLINK interrupts.

  clocks: true
  resets:
    maxItems: 1

  reset-names:
    items:
      - const: spi

  dmas:
    minItems: 2
    maxItems: 2

  dma-names:
    items:
      - const: rx
      - const: tx

  spi-max-frequency: true
  operating-points-v2: true
  power-domains: true

  '#address-cells':
    const: 1
  '#size-cells':
    const: 0

required:
  - compatible
  - reg
  - interrupts
  - clocks
  - resets
  - reset-names
  - dmas
  - dma-names

unevaluatedProperties: false

examples:
  - |
    spi@7000d600 {
      compatible = "nvidia,tegra20-slink";
      reg = <0x7000d600 0x200>;
      interrupts = <0 82 0x04>;
      spi-max-frequency = <25000000>;
      #address-cells = <1>;
      #size-cells = <0>;
      clocks = <&tegra_car 44>;
      resets = <&tegra_car 44>;
      reset-names = "spi";
      dmas = <&apbdma 16>, <&apbdma 16>;
      dma-names = "rx", "tx";
    };
```

## Documentation/devicetree/bindings/usb/nvidia,tegra20-ehci.yaml
```yaml
# SPDX-License-Identifier: (GPL-2.0 OR BSD-2-Clause)
%YAML 1.2
---
$id: "http://devicetree.org/schemas/usb/nvidia,tegra20-ehci.yaml#"
$schema: "http://devicetree.org/meta-schemas/core.yaml#"

title: Device tree binding for NVIDIA Tegra USB controllers

description: |
  The device node for a USB controller that is part of a Tegra SOC is as
  described in the document "Open Firmware Recommended Practice : Universal
  Serial Bus". Modifications and additions are detailed in this document.

maintainers:
  - Thierry Reding <treding@nvidia.com>
  - Jon Hunter <jonathanh@nvidia.com>

allOf:
  - $ref: "usb-hcd.yaml"

properties:
  compatible:
    oneOf:
      - items:
          - enum:
              - nvidia,tegra210-ehci
              - nvidia,tegra124-ehci
              - nvidia,tegra114-ehci
          - const: nvidia,tegra30-ehci
      - items:
          - const: nvidia,tegra30-ehci
      - items:
          - const: nvidia,tegra20-ehci

  reg:
    maxItems: 1

  interrupts:
    maxItems: 1

  dr_mode: true
  phy_type: true

  clocks:
    maxItems: 1

  resets:
    maxItems: 1

  reset-names:
    items:
      - const: usb

  operating-points-v2: true
  power-domains: true

  nvidia,phy:
    $ref: /schemas/types.yaml#/definitions/phandle
    description:
      phandle of the PHY that the controller is connected to

  nvidia,needs-double-reset:
    type: boolean
    description:
      This must be set for some instances of the USB controller found on
      Tegra20 that need to be reset twice due to some hardware issue.

unevaluatedProperties: false

required:
  - compatible
  - reg
  - interrupts
  - clocks
  - resets
  - reset-names
  - nvidia,phy

examples:
  - |
    #include <dt-bindings/clock/tegra20-car.h>
    #include <dt-bindings/interrupt-controller/arm-gic.h>

    usb@c5000000 {
        compatible = "nvidia,tegra20-ehci";
        reg = <0xc5000000 0x4000>;
        interrupts = <GIC_SPI 20 IRQ_TYPE_LEVEL_HIGH>;
        phy_type = "utmi";
        clocks = <&tegra_car TEGRA20_CLK_USBD>;
        resets = <&tegra_car 22>;
        reset-names = "usb";
        nvidia,needs-double-reset;
        nvidia,phy = <&phy1>;
    };

  - |
    #include <dt-bindings/clock/tegra30-car.h>
    #include <dt-bindings/interrupt-controller/arm-gic.h>

    usb@7d000000 {
        compatible = "nvidia,tegra30-ehci";
        reg = <0x7d000000 0x4000>;
        interrupts = <GIC_SPI 20 IRQ_TYPE_LEVEL_HIGH>;
        phy_type = "utmi";
        clocks = <&tegra_car TEGRA30_CLK_USBD>;
        resets = <&tegra_car 22>;
        reset-names = "usb";
        nvidia,needs-double-reset;
        nvidia,phy = <&phy1>;
    };

  - |
    #include <dt-bindings/clock/tegra114-car.h>
    #include <dt-bindings/interrupt-controller/arm-gic.h>

    usb@7d000000 {
        compatible = "nvidia,tegra114-ehci", "nvidia,tegra30-ehci";
        reg = <0x7d000000 0x4000>;
        interrupts = <GIC_SPI 20 IRQ_TYPE_LEVEL_HIGH>;
        phy_type = "utmi";
        clocks = <&tegra_car TEGRA114_CLK_USBD>;
        resets = <&tegra_car 22>;
        reset-names = "usb";
        nvidia,phy = <&phy1>;
    };

  - |
    #include <dt-bindings/clock/tegra124-car.h>
    #include <dt-bindings/interrupt-controller/arm-gic.h>

    usb@7d000000 {
        compatible = "nvidia,tegra124-ehci", "nvidia,tegra30-ehci";
        reg = <0x7d000000 0x4000>;
        interrupts = <GIC_SPI 20 IRQ_TYPE_LEVEL_HIGH>;
        phy_type = "utmi";
        clocks = <&tegra_car TEGRA124_CLK_USBD>;
        resets = <&tegra_car 22>;
        reset-names = "usb";
        nvidia,phy = <&phy1>;
    };

  - |
    #include <dt-bindings/clock/tegra210-car.h>
    #include <dt-bindings/interrupt-controller/arm-gic.h>

    usb@7d000000 {
        compatible = "nvidia,tegra210-ehci", "nvidia,tegra30-ehci";
        reg = <0x7d000000 0x4000>;
        interrupts = <GIC_SPI 20 IRQ_TYPE_LEVEL_HIGH>;
        phy_type = "utmi";
        clocks = <&tegra_car TEGRA210_CLK_USBD>;
        clock-names = "usb";
        resets = <&tegra_car 22>;
        reset-names = "usb";
        nvidia,phy = <&phy1>;
    };
```
