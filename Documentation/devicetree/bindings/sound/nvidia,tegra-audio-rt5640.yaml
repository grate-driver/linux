## Documentation/devicetree/bindings/sound/nvidia,tegra-audio.yaml
```yaml
# SPDX-License-Identifier: (GPL-2.0 OR BSD-2-Clause)
%YAML 1.2
---
$id: "http://devicetree.org/schemas/sound/nvidia,tegra-audio.yaml#"
$schema: "http://devicetree.org/meta-schemas/core.yaml#"

title: NVIDIA Tegra audio complex

maintainers:
  - Jon Hunter <jonathanh@nvidia.com>
  - Thierry Reding <thierry.reding@gmail.com>

properties:
  compatible:
    oneOf:
      - items:
          - pattern: '^[a-z0-9]+,tegra-audio-alc5632(-[a-z0-9])+'
          - const: nvidia,tegra-audio-alc5632
      - items:
          - enum:
              - nvidia,tegra-audio-max98090-nyan-big
              - nvidia,tegra-audio-max98090-nyan-blaze
          - const: nvidia,tegra-audio-max98090-nyan
          - const: nvidia,tegra-audio-max98090
      - items:
          - pattern: '^[a-z0-9]+,tegra-audio-max98090(-[a-z0-9])+'
          - const: nvidia,tegra-audio-max98090
      - items:
          - pattern: '^[a-z0-9]+,tegra-audio-rt56(39|40)(-[a-z0-9])+'
          - const: nvidia,tegra-audio-rt5640
      - items:
          - pattern: '^[a-z0-9]+,tegra-audio-rt5677(-[a-z0-9])+'
          - const: nvidia,tegra-audio-rt5677
      - items:
          - enum:
              - toradex,tegra-audio-sgtl5000-apalis_t30
              - toradex,tegra-audio-sgtl5000-colibri_t30
              - toradex,tegra-audio-sgtl5000-apalis_tk1
          - const: nvidia,tegra-audio-sgtl5000
      - const: nvidia,tegra-audio-trimslice
      - items:
          - pattern: '^[a-z0-9]+,tegra-audio-wm8753(-[a-z0-9])+'
          - const: nvidia,tegra-audio-wm8753
      - items:
          - pattern: '^[a-z0-9]+,tegra-audio-(plutux|wm8903(-[a-z0-9])+)'
          - const: nvidia,tegra-audio-wm8903
      - items:
          - pattern: '^[a-z0-9]+,tegra-audio-wm9712(-[a-z0-9])+'
          - const: nvidia,tegra-audio-wm9712

  clocks:
    items:
      - description: PLL A clock
      - description: PLL A OUT0 clock
      - description: The Tegra cdev1/extern1 clock, which feeds the card's mclk

  clock-names:
    items:
      - const: pll_a
      - const: pll_a_out0
      - const: mclk

  assigned-clocks: true

  assigned-clock-parents: true

  assigned-clock-rates: true

  nvidia,model:
    $ref: /schemas/types.yaml#/definitions/string
    description: The user-visible name of this sound complex.

  nvidia,audio-routing:
    $ref: /schemas/types.yaml#/definitions/non-unique-string-array
    description: |
      A list of the connections between audio components.
      Each entry is a pair of strings, the first being the connection's sink,
      the second being the connection's source. Valid names for sources and
      sinks are the pins (documented in the binding document),
      and the jacks on the board:
        ALC5632:
          * Headset Stereophone
          * Int Spk
          * Headset Mic
          * Digital Mic
        MAXX98090:
          * Headphones
          * SPeakers
          * Mic Jack
          * Int Mic
        RT5640:
          * Headphones
          * Speakers
          * Mic Jack
        RT5677:
          * Headphone
          * Speaker
          * Headset Mic
          * Internal Mic 1
          * Internal Mic 2
        SGTL5000:
          * Headphone Jack
          * Line In Jack
          * Mic Jack
        WM8753:
          * Headphone Jack
          * Mic Jack
        WM8903:
          * Headphone Jack
          * Int Spk
          * Mic Jack
          * Int Mic
        WM9712:
          * Headphone
          * LineIn
          * Mic

  nvidia,ac97-controller:
    $ref: /schemas/types.yaml#/definitions/phandle
    description: The phandle of the AC97 controller

  nvidia,i2s-controller:
    $ref: /schemas/types.yaml#/definitions/phandle
    description: The phandle of the Tegra I2S controller

  nvidia,audio-codec:
    $ref: /schemas/types.yaml#/definitions/phandle
    description: The phandle of audio codec

  nvidia,spkr-en-gpios:
    maxItems: 1
    description: The GPIO that enables the speakers

  nvidia,hp-mute-gpios:
    maxItems: 1
    description: The GPIO that mutes the headphones

  nvidia,hp-det-gpios:
    maxItems: 1
    description: The GPIO that detect headphones are plugged in

  nvidia,mic-det-gpios:
    maxItems: 1
    description: The GPIO that detect microphone is plugged in

  nvidia,int-mic-en-gpios:
    maxItems: 1
    description: The GPIO that enables the internal microphone

  nvidia,ext-mic-en-gpios:
    maxItems: 1
    description: The GPIO that enables the external microphone

  nvidia,headset:
    type: boolean
    description: The Mic Jack represents state of the headset microphone pin

additionalProperties: false

required:
  - compatible
  - clocks
  - clock-names

oneOf:
  - required:
      - nvidia,audio-codec
      - nvidia,i2s-controller
  - required:
      - nvidia,ac97-controller

examples:
  - |
    #include <dt-bindings/clock/tegra30-car.h>

    sound {
      compatible = "toradex,tegra-audio-sgtl5000-apalis_t30",
                   "nvidia,tegra-audio-sgtl5000";
      nvidia,model = "Toradex Apalis T30 SGTL5000";
      nvidia,audio-routing =
              "Headphone Jack", "HP_OUT",
              "LINE_IN", "Line In Jack",
              "MIC_IN", "Mic Jack";
      nvidia,i2s-controller = <&tegra_i2s2>;
      nvidia,audio-codec = <&codec>;
      clocks = <&tegra_car TEGRA30_CLK_PLL_A>,
               <&tegra_car TEGRA30_CLK_PLL_A_OUT0>,
               <&tegra_car TEGRA30_CLK_EXTERN1>;
      clock-names = "pll_a", "pll_a_out0", "mclk";
    };
```

## Documentation/devicetree/bindings/sound/nvidia,tegra30-i2s.yaml
```yaml
# SPDX-License-Identifier: (GPL-2.0-only OR BSD-2-Clause)
%YAML 1.2
---
$id: http://devicetree.org/schemas/sound/nvidia,tegra30-i2s.yaml#
$schema: http://devicetree.org/meta-schemas/core.yaml#

title: Tegra30 I2S Controller Device Tree Bindings

description: |
  The Inter-IC Sound (I2S) controller implements full-duplex,
  bi-directional and single direction point-to-point serial
  interfaces. It can interface with I2S compatible devices.
  I2S controller can operate both in master and slave mode.

maintainers:
  - Jon Hunter <jonathanh@nvidia.com>
  - Sameer Pujar <spujar@nvidia.com>

properties:
  $nodename:
    pattern: "^i2s@[0-9a-f]*$"

  compatible:
    oneOf:
      - const: nvidia,tegra30-i2s
      - const: nvidia,tegra124-i2s
      - items:
          - enum:
              - nvidia,tegra114-i2s
              - nvidia,tegra132-i2s
          - enum:
              - nvidia,tegra30-i2s
              - nvidia,tegra124-i2s

  reg:
    maxItems: 1

  clocks:
    maxItems: 1

  resets:
    maxItems: 1

  reset-names:
    enum: [i2s]

  nvidia,ahub-cif-ids:
    $ref: /schemas/types.yaml#/definitions/uint32-array
    description: |
      The list of AHUB CIF IDs for this port, rx (playback)
      first, tx (capture) second. See nvidia,tegra30-ahub.txt for values.

additionalProperties: false

examples:
  - |
    i2s@70080300 {
      compatible = "nvidia,tegra30-i2s";
      reg = <0x70080300 0x100>;
      nvidia,ahub-cif-ids = <4 4>;
      clocks = <&tegra_car 11>;
      resets = <&tegra_car 11>;
      reset-names = "i2s";
    };
```

## Documentation/devicetree/bindings/sound/realtek,rt5631.yaml
```yaml
# SPDX-License-Identifier: (GPL-2.0 OR BSD-2-Clause)
%YAML 1.2
---
$id: "http://devicetree.org/schemas/sound/realtek,rt5631.yaml#"
$schema: "http://devicetree.org/meta-schemas/core.yaml#"

title: ALC5631/RT5631 audio codec

description: |
  This device supports I2C only.
  Pins on the device (for linking into audio routes) for RT5631:
    * SPK_OUT_R_P
    * SPK_OUT_R_N
    * SPK_OUT_L_P
    * SPK_OUT_L_N
    * HP_OUT_L
    * HP_OUT_R
    * AUX_OUT2_LP
    * AUX_OUT2_RN
    * AUX_OUT1_LP
    * AUX_OUT1_RN
    * AUX_IN_L_JD
    * AUX_IN_R_JD
    * MONO_IN_P
    * MONO_IN_N
    * MIC1_P
    * MIC1_N
    * MIC2_P
    * MIC2_N
    * MONO_OUT_P
    * MONO_OUT_N
    * MICBIAS1
    * MICBIAS2

maintainers:
  - David Heidelberg <david@ixit.cz>

properties:
  compatible:
    enum:
      - realtek,alc5631
      - realtek,rt5631

  reg: true

required:
  - reg

additionalProperties: false

examples:
  - |
    i2c {
      #address-cells = <1>;
      #size-cells = <0>;

      alc5631: audio-codec@1a {
        compatible = "realtek,alc5631";
        reg = <0x1a>;
      };
    };
```

## Documentation/devicetree/bindings/sound/realtek,rt5640.yaml
```yaml
# SPDX-License-Identifier: (GPL-2.0 OR BSD-2-Clause)
%YAML 1.2
---
$id: "http://devicetree.org/schemas/sound/realtek,rt5640.yaml#"
$schema: "http://devicetree.org/meta-schemas/core.yaml#"

title: RT5640/RT5639 audio codec

description: |
  This device supports I2C only.
  Pins on the device (for linking into audio routes) for RT5639/RT5640:
    * DMIC1
    * DMIC2
    * MICBIAS1
    * IN1P
    * IN1N
    * IN2P
    * IN2N
    * IN3P
    * IN3N
    * HPOL
    * HPOR
    * LOUTL
    * LOUTR
    * SPOLP
    * SPOLN
    * SPORP
    * SPORN

  Additional pins on the device for RT5640:
    * MONOP
    * MONON

maintainers:
  - David Heidelberg <david@ixit.cz>

properties:
  compatible:
    enum:
      - realtek,rt5639
      - realtek,rt5640

  clocks:
    items:
      - description: The phandle of the master clock to the codec

  clock-names:
    items:
      - const: mclk

  reg: true
  interrupts: true

  realtek,in1-differential:
    type: boolean
    description: Indicate MIC1 input are differential, rather than single-ended.
  realtek,in2-differential:
    type: boolean
    description: Indicate MIC2 input are differential, rather than single-ended.
  realtek,in3-differential:
    type: boolean
    description: Indicate MIC3 input are differential, rather than single-ended.

  realtek,ldo1-en-gpios:
    maxItems: 1
    description: The GPIO that controls the CODEC's LDO1_EN pin.

  realtek,dmic1-data-pin:
    $ref: /schemas/types.yaml#/definitions/uint32
    enum:
      - 0 # DMIC1 is not used
      - 1 # using IN1P pin as DMIC1 data pin
      - 2 # using GPIO3 pin as DMIC1 data pin
    description: DMIC1 data pin

  realtek,dmic2-data-pin:
    $ref: /schemas/types.yaml#/definitions/uint32
    enum:
      - 0 # DMIC2 is not used
      - 1 # using IN1N pin as DMIC2 data pin
      - 2 # using GPIO4 pin as DMIC2 data pin
    description: DMIC2 data pin

  realtek,jack-detect-source:
    $ref: /schemas/types.yaml#/definitions/uint32
    enum:
      - 0 # jack-detect is not used
      - 1 # Use GPIO1
      - 2 # Use JD1_IN4P
      - 3 # Use JD2_IN4P
      - 4 # Use GPIO2
      - 5 # Use GPIO3
      - 6 # Use GPIO4
    description: Jack detection source

  realtek,jack-detect-not-inverted:
    type: boolean
    description: |
      Normal jack-detect switches give an inverted signal, set this bool
      in the rare case you've a jack-detect switch which is not inverted.

  realtek,over-current-threshold-microamp:
    description: micbias over-current detection threshold
    minimum: 600
    maximum: 2000
    multipleOf: 100

  realtek,over-current-scale-factor:
    $ref: /schemas/types.yaml#/definitions/uint32
    enum:
      - 0 # Scale current by 0.5
      - 1 # Scale current by 0.75
      - 2 # Scale current by 1.0
      - 3 # Scale current by 1.5
    description: micbias over-current detection scale-factor

required:
  - reg

additionalProperties: false

examples:
  - |
    #include <dt-bindings/gpio/gpio.h>
    #include <dt-bindings/gpio/tegra-gpio.h>
    #include <dt-bindings/interrupt-controller/irq.h>
    i2c {
      #address-cells = <1>;
      #size-cells = <0>;

      rt5640@1c {
        compatible = "realtek,rt5640";
        reg = <0x1c>;
        interrupt-parent = <&gpio>;
        interrupts = <TEGRA_GPIO(W, 3) IRQ_TYPE_LEVEL_HIGH>;
        realtek,ldo1-en-gpios = <&gpio TEGRA_GPIO(V, 3) GPIO_ACTIVE_HIGH>;
      };
    };
```
